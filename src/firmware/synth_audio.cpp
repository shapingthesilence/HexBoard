#include "FirmwareModule.h"

#if HEXBOARD_FIRMWARE_UNITY

// @synth
/*
    This section of the code handles audio
    output via the piezo buzzer and/or the
    headphone jack (on hardware v1.2 only)
  */
#include "hardware/pwm.h"  // library of code to access the processor's built in pulse wave modulation features
#include "hardware/irq.h"  // library of code to let you interrupt code execution to run something of higher priority
/*
    It is more convenient to pre-define the correct
    pulse wave modulation slice and channel associated
    with the PIEZO_PIN on this processor (see RP2040
    manual) than to have it looked up each time.
  */
constexpr byte PIEZO_PIN = 23;
constexpr byte PIEZO_SLICE = 3;
constexpr byte PIEZO_CHNL = 1;
constexpr byte AJACK_PIN = 25;
constexpr byte AJACK_SLICE = 4;
constexpr byte AJACK_CHNL = 1;
// midiD takes the following bitwise flags
constexpr byte AUDIO_NONE = 0;
constexpr byte AUDIO_PIEZO = 1;
constexpr byte AUDIO_AJACK = 2;
constexpr byte AUDIO_BOTH = 3;
byte audioD = AUDIO_AJACK;
bool synthBuzzerEnabled = false;
constexpr uint8_t HEADPHONE_VOLUME_CAP_FULL = 127;
byte headphoneVolumeCap = HEADPHONE_VOLUME_CAP_FULL;

inline bool audioJackAvailable() {
  return Hardware_Version == HARDWARE_V1_2;
}

inline bool decodeStoredBuzzerEnabled(uint8_t storedValue) {
  if (!audioJackAvailable()) {
    return true;
  }
  return (storedValue & AUDIO_PIEZO) != 0;
}

inline byte runtimeAudioDestination(bool buzzerEnabled) {
  if (!audioJackAvailable()) {
    return AUDIO_PIEZO;
  }
  return buzzerEnabled ? AUDIO_PIEZO : AUDIO_AJACK;
}

inline void syncAudioDestinationToRuntime() {
  audioD = runtimeAudioDestination(synthBuzzerEnabled);
}

// ============================================================
// PWM AUDIO CONFIG
// ============================================================
// Set PWM_BITS to 8, 9, or 10 to control PWM resolution.
// 8-bit: wrap=254 (the 1.2-era default, and the safer fallback if the current
//         synth path sounds too harsh in the upper registers)
// 9-bit: wrap=511 (middle-ground test mode: lower quantization noise than 8-bit
//        while keeping the carrier about an octave higher than 10-bit)
// 10-bit: wrap=1023 (the default compromise: lower quantization noise, but a
//         much lower PWM carrier)
//
// At the project's 250MHz build target with clkdiv=1 and phase-correct PWM:
// - 8-bit carrier is about 488kHz
// - 9-bit carrier is about 244kHz
// - 10-bit carrier is about 122kHz
//
// High notes, especially sine waves, can sound noticeably harsher with 10-bit
// PWM on typical output stages because the PWM residue sits much closer to the
// audio band. We still keep 10-bit as the default compromise, but 8-bit
// remains a one-line fallback if the jack path gets too "screamy."
#ifndef PWM_BITS
#define PWM_BITS 10
#endif

#if (PWM_BITS == 8)
  constexpr uint16_t PWM_WRAP = 254;
  constexpr int32_t  PWM_MID  = 127;
  constexpr int32_t  SHAPE_CLAMP = 127;
  constexpr int      OUTPUT_SHIFT = 8;   // derived above
  constexpr int      ENV_TO_A_SHIFT = 9; // 65535 >> 9 ~= 127
#elif (PWM_BITS == 10)
  constexpr uint16_t PWM_WRAP = 1023;
  constexpr int32_t  PWM_MID  = 512;
  constexpr int32_t  SHAPE_CLAMP = 511;
  constexpr int      OUTPUT_SHIFT = 6;   // derived above
  constexpr int      ENV_TO_A_SHIFT = 7; // 65535 >> 7 ~= 512
#elif (PWM_BITS == 9)
  constexpr uint16_t PWM_WRAP = 511;
  constexpr int32_t  PWM_MID  = 256;
  constexpr int32_t  SHAPE_CLAMP = 255;
  constexpr int      OUTPUT_SHIFT = 7;   // midway between 8-bit and 10-bit gain staging
  constexpr int      ENV_TO_A_SHIFT = 8; // 65535 >> 8 ~= 256
#else
  #error "PWM_BITS must be 8, 9, or 10"
#endif
constexpr uint16_t PIEZO_OFF_THRESHOLD = (PWM_BITS == 8) ? 1 : ((PWM_BITS == 9) ? 2 : 4);
constexpr int32_t METRONOME_BEEP_LEVEL = SHAPE_CLAMP / 3;
constexpr uint8_t AUDIO_DMA_TIMER_SLICE = 7;
constexpr uint8_t AUDIO_DMA_PWM_STEPS = 6;
constexpr uint16_t AUDIO_DMA_TIMER_WRAP = 1023;
constexpr uint16_t AUDIO_DMA_BUFFER_SAMPLE_COUNT = 64;
constexpr uint32_t AUDIO_DMA_SYS_CLOCK_HZ = 250000000u;
constexpr uint32_t AUDIO_SAMPLE_RATE_HZ =
  AUDIO_DMA_SYS_CLOCK_HZ / (static_cast<uint32_t>(AUDIO_DMA_TIMER_WRAP) + 1u) / AUDIO_DMA_PWM_STEPS;
constexpr uint32_t AUDIO_DMA_BUFFER_MICROS =
  (static_cast<uint64_t>(AUDIO_DMA_BUFFER_SAMPLE_COUNT) * 1000000ull) / AUDIO_SAMPLE_RATE_HZ;
constexpr uint8_t AUDIO_PWM_CC_LEVEL_SHIFT = 16;

struct AudioOutputLevels {
  uint16_t piezo = 0;
  uint16_t jack = static_cast<uint16_t>(PWM_MID);
  uint8_t voices = 0;
  uint8_t profileFlags = 0;
};

inline void RAM_FUNC(writeAudioOutputLevels)(uint16_t piezoLevel, uint16_t jackLevel) {
  if (audioD & AUDIO_PIEZO) {
    pwm_set_chan_level(PIEZO_SLICE, PIEZO_CHNL, piezoLevel);
  } else {
    pwm_set_chan_level(PIEZO_SLICE, PIEZO_CHNL, 0);
  }

  if (audioD & AUDIO_AJACK) {
    pwm_set_chan_level(AJACK_SLICE, AJACK_CHNL, jackLevel);
  } else {
    pwm_set_chan_level(AJACK_SLICE, AJACK_CHNL, static_cast<uint16_t>(PWM_MID));
  }
}

inline int32_t RAM_FUNC(scalePiezoSample)(int32_t sample, uint16_t amplitude) {
#if (PWM_BITS == 8)
  constexpr uint8_t PIEZO_SCALE_SHIFT = 7;
#elif (PWM_BITS == 9)
  constexpr uint8_t PIEZO_SCALE_SHIFT = 8;
#else
  constexpr uint8_t PIEZO_SCALE_SHIFT = 9;
#endif
  return (sample * static_cast<int32_t>(amplitude)) >> PIEZO_SCALE_SHIFT;
}

inline int32_t RAM_FUNC(applySynthDrive)(int32_t sample) {
  uint16_t gainQ8 = 256;
  switch (synthDrive) {
    case SYNTH_DRIVE_WARM: gainQ8 = 256; break;
    case SYNTH_DRIVE_EDGE: gainQ8 = 384; break;
    case SYNTH_DRIVE_DIRTY: gainQ8 = 640; break;
    case SYNTH_DRIVE_OFF:
    default:
      return sample;
  }

  int32_t x = (sample * static_cast<int32_t>(gainQ8)) >> 8;
  if (x > SHAPE_CLAMP) x = SHAPE_CLAMP;
  if (x < -SHAPE_CLAMP) x = -SHAPE_CLAMP;

  const bool negative = x < 0;
  const uint32_t mag = negative ? static_cast<uint32_t>(-x) : static_cast<uint32_t>(x);
#if (PWM_BITS == 8)
  constexpr uint8_t DRIVE_CLAMP_SHIFT = 7;
#elif (PWM_BITS == 9)
  constexpr uint8_t DRIVE_CLAMP_SHIFT = 8;
#else
  constexpr uint8_t DRIVE_CLAMP_SHIFT = 9;
#endif
  uint32_t cubeTerm = (((mag * mag) >> DRIVE_CLAMP_SHIFT) * mag) >> DRIVE_CLAMP_SHIFT;
  int32_t shaped = ((3 * static_cast<int32_t>(mag)) - static_cast<int32_t>(cubeTerm)) >> 1;
  if (shaped > SHAPE_CLAMP) shaped = SHAPE_CLAMP;
  return negative ? -shaped : shaped;
}
/*
    These definitions provide 8-bit samples to emulate.
    You can add your own as desired; it must
    be an array of 512 values, each from 0 to 255.
    Ideally the waveform is normalized so that the
    peaks are at 0 to 255, with 128 representing
    no wave movement. Phase zero should start at
    an upward zero crossing.
  */
const byte waveSineSource[] __in_flash("synth_waveforms") = {
  128, 130, 131, 133, 134, 136, 137, 139, 140, 142, 144, 145, 147, 148, 150, 151,
  153, 154, 156, 157, 159, 160, 162, 163, 165, 166, 168, 169, 171, 172, 174, 175,
  177, 178, 179, 181, 182, 184, 185, 186, 188, 189, 191, 192, 193, 195, 196, 197,
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  103, 105, 106, 108, 109, 111, 112, 114, 116, 117, 119, 120, 122, 123, 125, 126
};
const byte waveStringsSource[] __in_flash("synth_waveforms") = {
  128, 130, 131, 132, 132, 133, 134, 134, 135, 136, 136, 137, 138, 138, 139, 140,
  140, 140, 141, 142, 142, 143, 144, 144, 145, 146, 146, 146, 147, 148, 148, 148,
  149, 150, 150, 150, 151, 152, 152, 152, 152, 152, 153, 154, 154, 154, 154, 154,
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  117, 118, 119, 120, 120, 120, 121, 122, 123, 124, 124, 125, 126, 126, 127, 128
};
const byte waveClarinetSource[] __in_flash("synth_waveforms") = {
  128, 128, 129, 128, 128, 128, 127, 126, 126, 124, 123, 122, 121, 120, 118, 117,
  116, 115, 114, 113, 112, 111, 110, 110, 109, 109, 109, 109, 109, 110, 110, 110,
  111, 112, 112, 112, 113, 114, 114, 114, 114, 114, 114, 114, 113, 112, 111, 110,
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  112, 113, 114, 115, 116, 117, 118, 120, 121, 122, 123, 124, 126, 126, 127, 128
};
/*
    Imported MP single-cycle waveforms. The source WAVs are 2048-sample
    mono 32-bit float cycles rendered to 512-point tables; these tables are centered around 128 and
    rotated so phase zero starts at an upward zero crossing.
  */
const byte mpWaveMpSource[] __in_flash("synth_waveforms") = {
  128, 255, 255, 255, 255, 255, 255, 255, 255, 1, 1, 1, 1, 1, 1, 1,
  1, 255, 255, 255, 255, 255, 255, 255, 255, 1, 1, 1, 1, 1, 1, 1,
  1, 254, 252, 250, 248, 246, 244, 242, 240, 238, 236, 234, 232, 230, 228, 226,
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  128, 128, 128, 128, 128, 128, 128, 128, 128, 128, 128, 128, 128, 128, 128, 128
};
const byte mpWaveBoxSawSource[] __in_flash("synth_waveforms") = {
  128, 189, 189, 190, 190, 190, 190, 191, 191, 191, 191, 192, 192, 192, 193, 193,
  193, 193, 194, 194, 194, 195, 195, 195, 195, 196, 196, 196, 197, 197, 197, 197,
  198, 198, 198, 199, 199, 199, 199, 200, 200, 200, 201, 201, 201, 201, 202, 202,
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  63, 63, 63, 63, 64, 64, 64, 65, 65, 65, 65, 66, 66, 66, 67, 67
};
const byte mpWaveFriendlySquareSource[] __in_flash("synth_waveforms") = {
  128, 189, 219, 233, 244, 253, 253, 253, 253, 253, 254, 254, 254, 254, 254, 254,
  254, 255, 255, 255, 255, 255, 255, 255, 255, 255, 255, 255, 255, 255, 255, 255,
  255, 255, 254, 254, 254, 254, 254, 254, 253, 253, 253, 253, 252, 252, 252, 252,
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  119, 120, 121, 123, 124, 125, 126, 127, 128, 130, 131, 132, 133, 134, 135, 39
};
const byte mpWaveGlassySource[] __in_flash("synth_waveforms") = {
  128, 132, 135, 139, 142, 145, 148, 151, 153, 156, 158, 160, 162, 164, 166, 168,
  170, 172, 174, 176, 178, 180, 182, 184, 186, 188, 190, 192, 194, 196, 198, 200,
  202, 204, 206, 208, 210, 212, 214, 216, 218, 219, 221, 223, 225, 226, 228, 229,
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  90, 87, 86, 85, 85, 87, 89, 92, 95, 99, 103, 107, 112, 116, 120, 124
};
const byte mpWaveKoolaidSource[] __in_flash("synth_waveforms") = {
  128, 196, 203, 166, 139, 128, 112, 95, 83, 77, 75, 80, 86, 99, 109, 118,
  131, 147, 159, 172, 183, 196, 204, 213, 222, 229, 239, 241, 242, 245, 246, 248,
  252, 254, 253, 250, 249, 248, 248, 246, 244, 242, 240, 238, 238, 237, 234, 234,
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  123, 123, 122, 120, 117, 117, 113, 111, 112, 115, 116, 116, 115, 117, 122, 106
};
const byte mpWaveMervSource[] __in_flash("synth_waveforms") = {
  128, 156, 115, 121, 113, 113, 176, 159, 141, 146, 133, 140, 58, 102, 98, 140,
  106, 106, 113, 155, 85, 108, 185, 88, 73, 117, 195, 201, 123, 29, 78, 92,
  217, 142, 112, 160, 94, 78, 135, 152, 151, 178, 131, 236, 79, 127, 80, 113,
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  126, 108, 177, 173, 144, 111, 116, 100, 134, 72, 74, 120, 82, 60, 115, 145
};
const byte mpWaveMBellishSource[] __in_flash("synth_waveforms") = {
  128, 132, 133, 133, 131, 130, 130, 131, 132, 133, 133, 131, 130, 129, 130, 131,
  133, 135, 135, 135, 134, 135, 138, 143, 149, 154, 159, 163, 166, 170, 174, 179,
  182, 184, 184, 182, 179, 176, 174, 173, 172, 171, 169, 166, 162, 160, 159, 159,
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  64, 66, 66, 66, 66, 68, 72, 77, 84, 90, 96, 101, 106, 111, 117, 123
};
const byte mpWaveOvalSource[] __in_flash("synth_waveforms") = {
  128, 131, 133, 136, 139, 141, 144, 147, 149, 152, 154, 157, 159, 162, 164, 166,
  169, 171, 173, 175, 177, 179, 182, 184, 186, 187, 189, 191, 193, 195, 197, 199,
  200, 202, 204, 205, 207, 209, 210, 212, 213, 215, 216, 218, 219, 220, 222, 223,
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  102, 101, 101, 101, 102, 103, 105, 106, 108, 110, 113, 115, 117, 120, 123, 125
};
const byte mpWavePrettyShapeSource[] __in_flash("synth_waveforms") = {
  128, 130, 133, 135, 137, 139, 142, 144, 146, 148, 151, 153, 155, 157, 160, 162,
  164, 166, 169, 171, 173, 175, 177, 179, 181, 183, 186, 188, 190, 192, 194, 196,
  198, 200, 202, 203, 205, 207, 209, 211, 213, 214, 216, 218, 219, 221, 223, 224,
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  92, 94, 96, 99, 101, 103, 105, 108, 110, 112, 114, 117, 119, 121, 123, 126
};
const byte mpWaveQuick808Source[] __in_flash("synth_waveforms") = {
  128, 132, 135, 139, 142, 146, 149, 153, 156, 160, 163, 166, 170, 173, 176, 179,
  182, 185, 188, 191, 194, 196, 199, 202, 204, 207, 209, 211, 214, 216, 218, 220,
  222, 224, 226, 228, 230, 231, 233, 234, 236, 237, 239, 240, 241, 243, 244, 245,
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  71, 74, 77, 81, 85, 88, 92, 95, 99, 102, 106, 110, 113, 117, 121, 124
};
const byte mpWaveRichRepeaterSource[] __in_flash("synth_waveforms") = {
  128, 216, 235, 243, 248, 250, 252, 253, 253, 253, 253, 252, 250, 248, 244, 238,
  227, 203, 119, 48, 28, 19, 14, 10, 8, 7, 6, 6, 6, 7, 8, 11,
  14, 19, 28, 48, 113, 202, 227, 239, 245, 249, 251, 253, 254, 254, 254, 254,
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  12, 6, 4, 2, 1, 1, 1, 2, 2, 3, 4, 5, 8, 12, 21, 41
};
const byte mpWaveRoundedTriangleSource[] __in_flash("synth_waveforms") = {
  128, 129, 130, 131, 132, 133, 134, 135, 136, 137, 138, 139, 140, 141, 142, 143,
  144, 145, 147, 148, 149, 150, 151, 152, 153, 154, 155, 156, 157, 158, 159, 160,
  161, 162, 163, 164, 166, 167, 168, 169, 170, 171, 172, 173, 174, 175, 176, 177,
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  112, 113, 114, 115, 116, 117, 118, 119, 120, 121, 122, 123, 124, 125, 126, 127
};
const byte mpWaveStardewSource[] __in_flash("synth_waveforms") = {
  128, 133, 128, 132, 129, 129, 128, 128, 127, 126, 129, 122, 123, 126, 125, 125,
  125, 123, 124, 122, 123, 123, 122, 120, 121, 123, 120, 121, 120, 121, 121, 118,
  120, 121, 121, 118, 117, 121, 119, 118, 119, 119, 117, 114, 121, 115, 117, 114,
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  136, 139, 137, 139, 135, 133, 133, 133, 133, 135, 132, 130, 130, 131, 135, 131
};
const byte mpWaveSyncTheTitanicSource[] __in_flash("synth_waveforms") = {
  128, 129, 131, 132, 133, 134, 135, 136, 137, 138, 139, 139, 140, 141, 141, 141,
  142, 142, 142, 142, 142, 142, 142, 142, 142, 142, 141, 141, 140, 140, 139, 139,
  138, 137, 136, 135, 134, 133, 132, 130, 129, 128, 126, 125, 123, 121, 120, 118,
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  96, 99, 101, 104, 106, 108, 110, 112, 114, 116, 118, 120, 122, 123, 125, 127
};
const byte mpWaveWeirdWizardSource[] __in_flash("synth_waveforms") = {
  128, 129, 130, 132, 133, 134, 136, 138, 140, 142, 144, 146, 149, 152, 155, 158,
  161, 164, 167, 170, 174, 177, 181, 184, 187, 191, 194, 197, 200, 204, 207, 210,
  213, 215, 218, 221, 223, 226, 228, 230, 232, 234, 236, 238, 240, 241, 243, 244,
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  112, 113, 114, 115, 116, 117, 118, 119, 120, 121, 122, 123, 124, 125, 126, 127
};
const byte mpWaveWooSource[] __in_flash("synth_waveforms") = {
  128, 131, 133, 135, 136, 138, 139, 139, 140, 140, 140, 139, 139, 138, 137, 135,
  134, 132, 130, 128, 126, 124, 122, 120, 117, 115, 113, 111, 108, 106, 104, 102,
  100, 99, 97, 95, 94, 92, 91, 90, 89, 88, 88, 87, 87, 86, 86, 86,
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  48, 56, 63, 69, 75, 81, 87, 92, 97, 102, 107, 111, 115, 118, 122, 125
};

constexpr uint16_t SYNTH_WAVE_SAMPLE_COUNT = 512;
constexpr uint8_t SYNTH_WAVE_SAMPLE_BITS = 9;
constexpr uint8_t SYNTH_WAVE_PHASE_FRACTION_BITS = 16 - SYNTH_WAVE_SAMPLE_BITS;
constexpr uint16_t SYNTH_WAVE_PHASE_FRACTION_MASK = (1u << SYNTH_WAVE_PHASE_FRACTION_BITS) - 1;
constexpr uint8_t SYNTH_WAVETABLE_FRAME_COUNT = 32;
constexpr uint8_t SYNTH_WAVETABLE_LAST_FRAME = SYNTH_WAVETABLE_FRAME_COUNT - 1;
constexpr size_t SYNTH_WAVETABLE_SAMPLE_BYTES = static_cast<size_t>(SYNTH_WAVETABLE_FRAME_COUNT) * SYNTH_WAVE_SAMPLE_COUNT;
byte activeSynthWaveTable[SYNTH_WAVETABLE_FRAME_COUNT][SYNTH_WAVE_SAMPLE_COUNT] = {};
byte synthVibratoSine[SYNTH_WAVE_SAMPLE_COUNT] = {};
volatile bool synthWaveTableLoadInProgress = false;
byte loadedSynthWaveform = 255;
volatile uint8_t activeSynthWaveFrameCount = 1;
uint16_t synthWavetableFramePositionByAmount[128] = {};
uint16_t synthMorphPhaseWarpScaleByDepth[128] = {};
uint8_t synthFxModScaleByDepth[128][128] = {};
bool userSynthWavetableAvailable = false;
/*
    The sine wavetable benefits the most from
    interpolation because it has the fewest
    intentional harmonics to mask staircase
    artifacts in the upper registers.

    The phase accumulator already runs at 16-bit
    precision. With 512-entry tables, the high
    9 bits select a sample and the low 7 bits
    provide the fractional weight between adjacent
    8-bit table entries. The returned sample is
    in the same 0..65535 range used by the rest
    of the synth path.
  */
inline uint16_t RAM_FUNC(synthWaveSampleIndexFromPhase16)(uint16_t phase) {
  return phase >> SYNTH_WAVE_PHASE_FRACTION_BITS;
}

inline uint16_t RAM_FUNC(synthWaveSampleIndexFromPhase32)(uint32_t phase) {
  return phase >> (32 - SYNTH_WAVE_SAMPLE_BITS);
}

inline uint8_t RAM_FUNC(synthWaveInterpolationFraction)(uint16_t phase) {
  return static_cast<uint8_t>((phase & SYNTH_WAVE_PHASE_FRACTION_MASK) << (8 - SYNTH_WAVE_PHASE_FRACTION_BITS));
}

inline uint16_t RAM_FUNC(synthWavePhaseFromSampleIndex)(uint16_t sampleIndex) {
  return static_cast<uint16_t>(sampleIndex << SYNTH_WAVE_PHASE_FRACTION_BITS);
}

inline uint16_t RAM_FUNC(interpolatedWaveSample)(const byte* table, uint16_t phase) {
  uint16_t index = synthWaveSampleIndexFromPhase16(phase);
  uint16_t nextIndex = static_cast<uint16_t>(index + 1);
  if (nextIndex >= SYNTH_WAVE_SAMPLE_COUNT) {
    nextIndex = 0;
  }
  uint8_t frac = synthWaveInterpolationFraction(phase);
  int32_t sampleA = table[index];
  int32_t sampleB = table[nextIndex];
  return static_cast<uint16_t>((sampleA << 8) + ((sampleB - sampleA) * static_cast<int32_t>(frac)));
}
/*
    The hybrid synth sound blends between
    square, saw, and triangle waveforms
    at different frequencies. Said frequencies
    are controlled via constants here.
  */
#define TRANSITION_SQUARE 220.0
#define TRANSITION_SAW_LOW 440.0
#define TRANSITION_SAW_HIGH 880.0
#define TRANSITION_TRIANGLE 1760.0
/*
    The audio sample interval is set by a dedicated PWM
    timer slice that paces DMA writes into the output PWM
    compare register. With the default 1023 timer wrap and
    /6 divider at the 250 MHz build target, the sample rate
    is about 40.7 kHz.
  */
constexpr uint32_t POLL_INTERVAL_IN_MICROSECONDS =
  (1000000u + (AUDIO_SAMPLE_RATE_HZ / 2u)) / AUDIO_SAMPLE_RATE_HZ;
constexpr uint8_t SYNTH_PITCH_SMOOTH_SHIFT = 9;
constexpr uint8_t SYNTH_MOD_SMOOTH_SHIFT = 9;
constexpr uint32_t audioPhaseIncrementFromHz(uint16_t hz) {
  return static_cast<uint32_t>((static_cast<uint64_t>(hz) * 4294967296ULL) / AUDIO_SAMPLE_RATE_HZ);
}
constexpr uint32_t audioPhaseIncrementFromMilliHz(uint32_t milliHz) {
  return static_cast<uint32_t>((static_cast<uint64_t>(milliHz) * 4294967296ULL) / (static_cast<uint64_t>(AUDIO_SAMPLE_RATE_HZ) * 1000ULL));
}
constexpr std::array<uint32_t, 12> synthVibratoPhaseIncrementOptions = {
  audioPhaseIncrementFromHz(1),
  audioPhaseIncrementFromHz(2),
  audioPhaseIncrementFromHz(3),
  audioPhaseIncrementFromHz(4),
  audioPhaseIncrementFromHz(5),
  audioPhaseIncrementFromHz(6),
  audioPhaseIncrementFromHz(7),
  audioPhaseIncrementFromHz(8),
  audioPhaseIncrementFromHz(9),
  audioPhaseIncrementFromHz(10),
  audioPhaseIncrementFromHz(11),
  audioPhaseIncrementFromHz(12)
};
constexpr std::array<uint32_t, 20> synthLfoPhaseIncrementOptions = {
  audioPhaseIncrementFromMilliHz(50),
  audioPhaseIncrementFromMilliHz(100),
  audioPhaseIncrementFromMilliHz(200),
  audioPhaseIncrementFromMilliHz(333),
  audioPhaseIncrementFromMilliHz(500),
  audioPhaseIncrementFromMilliHz(750),
  audioPhaseIncrementFromMilliHz(1000),
  audioPhaseIncrementFromMilliHz(1250),
  audioPhaseIncrementFromMilliHz(1500),
  audioPhaseIncrementFromMilliHz(2000),
  audioPhaseIncrementFromMilliHz(2500),
  audioPhaseIncrementFromMilliHz(3000),
  audioPhaseIncrementFromMilliHz(4000),
  audioPhaseIncrementFromMilliHz(5000),
  audioPhaseIncrementFromMilliHz(6000),
  audioPhaseIncrementFromMilliHz(8000),
  audioPhaseIncrementFromMilliHz(10000),
  audioPhaseIncrementFromMilliHz(12000),
  audioPhaseIncrementFromMilliHz(16000),
  audioPhaseIncrementFromMilliHz(20000)
};
constexpr uint16_t METRONOME_BEEP_SAMPLE_COUNT =
  static_cast<uint16_t>((40000ULL * AUDIO_SAMPLE_RATE_HZ + 999999ULL) / 1000000ULL);
constexpr uint32_t METRONOME_BEEP_NORMAL_INCREMENT = audioPhaseIncrementFromHz(1200);
constexpr uint32_t METRONOME_BEEP_ACCENT_INCREMENT = audioPhaseIncrementFromHz(1800);

inline void RAM_FUNC(recordISRProfileSample)(uint32_t startTime, uint8_t voices, uint8_t flags) {
  uint32_t dt = timer_hw->timerawl - startTime;
  if (dt < isrCycleMin) {
    isrCycleMin = dt;
  }
  if (dt > isrCycleMax) {
    isrCycleMax = dt;
    isrCycleMaxVoices = voices;
    isrCycleMaxFlags = flags;
  }
  if (dt > POLL_INTERVAL_IN_MICROSECONDS) {
    isrCycleOverrunCount++;
  }
  if (flags & ISR_PROFILE_FLAG_PIEZO_SCALE) {
    isrCyclePiezoScaleCount++;
  }
  isrCycleSum += dt;
  isrCycleCount++;
}

inline void RAM_FUNC(recordAudioBufferProfileSample)(uint32_t startTime, uint8_t voices, uint8_t flags) {
  uint32_t dt = timer_hw->timerawl - startTime;
  if (dt < isrCycleMin) {
    isrCycleMin = dt;
  }
  if (dt > isrCycleMax) {
    isrCycleMax = dt;
    isrCycleMaxVoices = voices;
    isrCycleMaxFlags = flags;
  }
  if (dt > AUDIO_DMA_BUFFER_MICROS) {
    isrCycleOverrunCount++;
  }
  if (flags & ISR_PROFILE_FLAG_PIEZO_SCALE) {
    isrCyclePiezoScaleCount++;
  }
  isrCycleSum += dt;
  isrCycleCount++;
}

inline uint32_t RAM_FUNC(oscillatorIncrementFromFrequency)(float frequency) {
  if (frequency <= 0.0f) {
    return 0;
  }
  constexpr float incrementScale = 4294967296.0f / static_cast<float>(AUDIO_SAMPLE_RATE_HZ);
  float increment = frequency * incrementScale;
  const float maxIncrement = static_cast<float>(std::numeric_limits<uint32_t>::max());
  if (increment >= maxIncrement) {
    return std::numeric_limits<uint32_t>::max();
  }
  return static_cast<uint32_t>(round(increment));
}

inline void RAM_FUNC(smoothUint32Toward)(uint32_t& current, uint32_t target, uint8_t shift) {
  if (current == target) {
    return;
  }
  if (target > current) {
    uint32_t step = (target - current) >> shift;
    if (step == 0) {
      step = 1;
    }
    current += step;
    if (current > target) {
      current = target;
    }
  } else {
    uint32_t step = (current - target) >> shift;
    if (step == 0) {
      step = 1;
    }
    current -= step;
    if (current < target) {
      current = target;
    }
  }
}

inline void RAM_FUNC(smoothUint32Toward)(uint32_t& current, uint32_t target, uint8_t shift, uint8_t elapsedTicks) {
  if (elapsedTicks == 0 || current == target) {
    return;
  }
  if (target > current) {
    uint32_t difference = target - current;
    uint64_t step = difference >> shift;
    if (step == 0) {
      step = 1;
    }
    step *= elapsedTicks;
    current += static_cast<uint32_t>(step >= difference ? difference : step);
  } else {
    uint32_t difference = current - target;
    uint64_t step = difference >> shift;
    if (step == 0) {
      step = 1;
    }
    step *= elapsedTicks;
    current -= static_cast<uint32_t>(step >= difference ? difference : step);
  }
}

inline void RAM_FUNC(smoothUint16Toward)(uint16_t& current, uint16_t target, uint8_t shift) {
  if (current == target) {
    return;
  }
  if (target > current) {
    uint16_t step = (target - current) >> shift;
    if (step == 0) {
      step = 1;
    }
    current += step;
    if (current > target) {
      current = target;
    }
  } else {
    uint16_t step = (current - target) >> shift;
    if (step == 0) {
      step = 1;
    }
    current -= step;
    if (current < target) {
      current = target;
    }
  }
}

inline void RAM_FUNC(smoothUint16Toward)(uint16_t& current, uint16_t target, uint8_t shift, uint8_t elapsedTicks) {
  if (elapsedTicks == 0 || current == target) {
    return;
  }
  if (target > current) {
    uint16_t difference = target - current;
    uint32_t step = difference >> shift;
    if (step == 0) {
      step = 1;
    }
    step *= elapsedTicks;
    current += static_cast<uint16_t>(step >= difference ? difference : step);
  } else {
    uint16_t difference = current - target;
    uint32_t step = difference >> shift;
    if (step == 0) {
      step = 1;
    }
    step *= elapsedTicks;
    current -= static_cast<uint16_t>(step >= difference ? difference : step);
  }
}

inline uint32_t RAM_FUNC(ticksFromMicros)(uint32_t micros) {
  if (micros == 0) {
    return 0;
  }
  return static_cast<uint32_t>((static_cast<uint64_t>(micros) * AUDIO_SAMPLE_RATE_HZ + 999999ULL) / 1000000ULL);
}

inline uint32_t RAM_FUNC(envelopeAudioLevel)(uint32_t level) {
  if (level > envelopeMaxLevel) {
    level = envelopeMaxLevel;
  }
  return level >> ENVELOPE_LEVEL_SCALE_SHIFT;
}

inline uint16_t RAM_FUNC(releaseIncrementForLevel)(uint32_t level) {
  if (level == 0) {
    return 1;
  }
  uint32_t bucket = (level - 1) >> ENVELOPE_RELEASE_INCREMENT_SHIFT;
  if (bucket >= envelopeReleaseIncrementByLevel.size()) {
    bucket = envelopeReleaseIncrementByLevel.size() - 1;
  }
  uint16_t increment = envelopeReleaseIncrementByLevel[bucket];
  return increment ? increment : 1;
}

inline uint16_t RAM_FUNC(effectReleaseIncrementForLevel)(uint8_t envelopeIndex, uint32_t level) {
  if (level == 0) {
    return 1;
  }
  uint32_t bucket = (level - 1) >> ENVELOPE_RELEASE_INCREMENT_SHIFT;
  if (bucket >= effectEnvelopeReleaseIncrementByLevel[envelopeIndex].size()) {
    bucket = effectEnvelopeReleaseIncrementByLevel[envelopeIndex].size() - 1;
  }
  uint16_t increment = effectEnvelopeReleaseIncrementByLevel[envelopeIndex][bucket];
  return increment ? increment : 1;
}

struct EnvelopeState {
  uint32_t level = 0;
  uint16_t releaseIncrement = 0;
  uint32_t holdTicksRemaining = 0;
  EnvelopeStage stage = EnvelopeStage::Idle;
};

inline void RAM_FUNC(resetEnvelopeState)(EnvelopeState& env) {
  env.level = 0;
  env.releaseIncrement = 0;
  env.holdTicksRemaining = 0;
  env.stage = EnvelopeStage::Idle;
}

std::array<EnvelopeState, POLYPHONY_LIMIT> envelopeStates;
std::array<std::array<EnvelopeState, POLYPHONY_LIMIT>, SYNTH_FX_ENVELOPE_COUNT> effectEnvelopeStates;
int16_t cachedEffectEnvelopeModValues[SYNTH_FX_ENVELOPE_COUNT][POLYPHONY_LIMIT] = {};
enum class EnvelopeCommand : uint8_t {
  None,
  StartAttack,
  StartRelease,
  Reset
};

// Core 0 publishes the latest envelope command for each voice, and the audio
// ISR on core 1 consumes it. The sequence byte tells the consumer whether a
// newer command has arrived since the last poll.
volatile uint8_t envelopeCommandValues[POLYPHONY_LIMIT] = {};
volatile uint8_t envelopeCommandPublishedSeq[POLYPHONY_LIMIT] = {};
std::array<uint8_t, POLYPHONY_LIMIT> envelopeCommandConsumedSeq = {};

// The opposite direction is simpler: core 1 only needs to tell core 0 that a
// voice has fully finished and can return to the free list. A sequence byte is
// enough because "voice finished" is an idempotent event.
volatile uint8_t voiceFreedPublishedSeq[POLYPHONY_LIMIT] = {};
std::array<uint8_t, POLYPHONY_LIMIT> voiceFreedConsumedSeq = {};
std::array<std::atomic<bool>, POLYPHONY_LIMIT> channelInUse = {};
std::array<std::atomic<uint32_t>, POLYPHONY_LIMIT> voiceGenerations;
std::array<std::atomic<int16_t>, POLYPHONY_LIMIT> synthChannelOwners;
std::atomic<uint32_t> nextVoiceGeneration = 1;
// Flag set by Core 0 before flash writes. When true, the audio renderer outputs
// silence so DMA resumes cleanly after flash operations (which disable all
// interrupts on both cores of the RP2040).
std::atomic<bool> flashWriteInProgress = false;
constexpr int16_t NO_SYNTH_OWNER = -1;
float pitchBendFactor = 1.0f;
std::array<uint8_t, POLYPHONY_LIMIT> releaseRetries = {};
std::array<uint8_t, POLYPHONY_LIMIT> releaseRetryCountdown = {};

constexpr uint8_t releaseRetryLimit = 2;
constexpr uint8_t releaseRetryDelayLoops = 2;

// Publish the newest command for one voice. The command byte is written first,
// then a memory barrier makes sure core 1 cannot observe the new sequence
// number before the matching command value is visible.
inline void RAM_FUNC(publishEnvelopeCommand)(uint8_t channel, EnvelopeCommand command) {
  envelopeCommandValues[channel] = static_cast<uint8_t>(command);
  __dmb();
  envelopeCommandPublishedSeq[channel] = static_cast<uint8_t>(envelopeCommandPublishedSeq[channel] + 1);
}

// Read the newest command once. Returning None means nothing new arrived since
// the last ISR iteration for this voice.
inline EnvelopeCommand RAM_FUNC(consumeEnvelopeCommand)(uint8_t channel) {
  uint8_t publishedSeq = envelopeCommandPublishedSeq[channel];
  if (publishedSeq == envelopeCommandConsumedSeq[channel]) {
    return EnvelopeCommand::None;
  }
  __dmb();
  EnvelopeCommand command = static_cast<EnvelopeCommand>(envelopeCommandValues[channel]);
  envelopeCommandConsumedSeq[channel] = publishedSeq;
  return command;
}

// Core 1 uses this when a release truly reaches zero. Core 0 later consumes
// the event and pushes the voice back into the available-channel queue.
inline void RAM_FUNC(publishVoiceFreed)(uint8_t channel) {
  __dmb();
  voiceFreedPublishedSeq[channel] = static_cast<uint8_t>(voiceFreedPublishedSeq[channel] + 1);
}

// Core 0 checks whether core 1 has published a newer "voice finished" event.
inline bool RAM_FUNC(consumeVoiceFreed)(uint8_t channel) {
  uint8_t publishedSeq = voiceFreedPublishedSeq[channel];
  if (publishedSeq == voiceFreedConsumedSeq[channel]) {
    return false;
  }
  __dmb();
  voiceFreedConsumedSeq[channel] = publishedSeq;
  return true;
}

// When core 0 immediately reuses a voice, any older pending "voice finished"
// event for that same channel must be ignored so it cannot free the new note.
inline void RAM_FUNC(clearPendingVoiceFreed)(uint8_t channel) {
  __dmb();
  voiceFreedConsumedSeq[channel] = voiceFreedPublishedSeq[channel];
}

void updateEnvelopeReleaseIncrementTable(EnvelopeParams& params, std::array<uint16_t, ENVELOPE_RELEASE_INCREMENT_BUCKETS>& releaseTable) {
  for (size_t bucket = 0; bucket < releaseTable.size(); ++bucket) {
    uint32_t bucketLevel = static_cast<uint32_t>(bucket + 1) << ENVELOPE_RELEASE_INCREMENT_SHIFT;
    if (bucketLevel > envelopeMaxLevel) {
      bucketLevel = envelopeMaxLevel;
    }
    uint32_t increment = (params.releaseTicks == 0)
                           ? std::numeric_limits<uint16_t>::max()
                           : std::max<uint32_t>(
                               1,
                               (bucketLevel + (params.releaseTicks >> 1)) / params.releaseTicks);
    if (increment > std::numeric_limits<uint16_t>::max()) {
      increment = std::numeric_limits<uint16_t>::max();
    }
    releaseTable[bucket] = static_cast<uint16_t>(increment);
  }
}

void updateEnvelopeParamsFromValues(EnvelopeParams& params,
                                    uint8_t& attackIndex,
                                    uint8_t& holdIndex,
                                    uint8_t& decayIndex,
                                    uint8_t& sustainLevel,
                                    uint8_t& releaseIndex,
                                    std::array<uint16_t, ENVELOPE_RELEASE_INCREMENT_BUCKETS>& releaseTable) {
  auto clampIndex = [](uint8_t& index) {
    if (index >= envelopeTimeMicrosOptions.size()) {
      index = static_cast<uint8_t>(envelopeTimeMicrosOptions.size() - 1);
    }
  };

  clampIndex(attackIndex);
  clampIndex(holdIndex);
  clampIndex(decayIndex);
  clampIndex(releaseIndex);

  uint32_t attackMicros = envelopeTimeMicrosOptions[attackIndex];
  params.attackTicks = ticksFromMicros(attackMicros);
  params.attackIncrement = (params.attackTicks == 0)
                             ? envelopeMaxLevel
                             : std::max<uint32_t>(1, (envelopeMaxLevel + params.attackTicks - 1) / params.attackTicks);

  uint32_t holdMicros = envelopeTimeMicrosOptions[holdIndex];
  params.holdTicks = ticksFromMicros(holdMicros);

  sustainLevel = std::min<uint8_t>(127, sustainLevel);
  params.sustainLevel = (static_cast<uint32_t>(sustainLevel) * envelopeMaxLevel) / 127;

  uint32_t decayMicros = envelopeTimeMicrosOptions[decayIndex];
  params.decayTicks = ticksFromMicros(decayMicros);
  if (params.decayTicks == 0 || params.sustainLevel >= envelopeMaxLevel) {
    params.decayIncrement = envelopeMaxLevel;
  } else {
    uint32_t difference = envelopeMaxLevel - params.sustainLevel;
    params.decayIncrement = std::max<uint32_t>(1, (difference + params.decayTicks - 1) / params.decayTicks);
  }

  uint32_t releaseMicros = envelopeTimeMicrosOptions[releaseIndex];
  params.releaseTicks = ticksFromMicros(releaseMicros);
  updateEnvelopeReleaseIncrementTable(params, releaseTable);
}

void updateEnvelopeParamsFromSettings() {
  updateEnvelopeParamsFromValues(envelopeParams,
                                 envelopeAttackIndex,
                                 envelopeHoldIndex,
                                 envelopeDecayIndex,
                                 envelopeSustainLevel,
                                 envelopeReleaseIndex,
                                 envelopeReleaseIncrementByLevel);
}

std::array<bool, SYNTH_FX_ENVELOPE_COUNT> synthEffectEnvelopeActive = { false, false };

inline int16_t synthEffectAmountDepth(uint8_t amountSetting) {
  return static_cast<int16_t>(amountSetting) - static_cast<int16_t>(SYNTH_FX_AMOUNT_OFF);
}

inline void RAM_FUNC(advanceEnvelopeFromAttackPeak)(const EnvelopeParams& params, EnvelopeState& env) {
  env.level = envelopeMaxLevel;
  if (params.holdTicks != 0) {
    env.stage = EnvelopeStage::Hold;
    env.holdTicksRemaining = params.holdTicks;
  } else if (params.decayTicks == 0 || params.sustainLevel >= envelopeMaxLevel) {
    env.stage = EnvelopeStage::Sustain;
    env.level = params.sustainLevel;
    env.holdTicksRemaining = 0;
  } else {
    env.stage = EnvelopeStage::Decay;
    env.holdTicksRemaining = 0;
  }
}

inline void RAM_FUNC(updateEnvelopeHoldStage)(const EnvelopeParams& params, EnvelopeState& env) {
  env.level = envelopeMaxLevel;
  if (env.holdTicksRemaining > 1) {
    --env.holdTicksRemaining;
    return;
  }
  env.holdTicksRemaining = 0;
  if (params.decayTicks == 0 || params.sustainLevel >= envelopeMaxLevel) {
    env.stage = EnvelopeStage::Sustain;
    env.level = params.sustainLevel;
  } else {
    env.stage = EnvelopeStage::Decay;
  }
}

void updateEffectEnvelopeParamsFromSettings(uint8_t envelopeIndex) {
  if (envelopeIndex >= SYNTH_FX_ENVELOPE_COUNT) {
    return;
  }
  updateEnvelopeParamsFromValues(effectEnvelopeParams[envelopeIndex],
                                 effectEnvelopeAttackIndex[envelopeIndex],
                                 effectEnvelopeHoldIndex[envelopeIndex],
                                 effectEnvelopeDecayIndex[envelopeIndex],
                                 effectEnvelopeSustainLevel[envelopeIndex],
                                 effectEnvelopeReleaseIndex[envelopeIndex],
                                 effectEnvelopeReleaseIncrementByLevel[envelopeIndex]);
  bool envelopeShapeActive = (effectEnvelopeAttackIndex[envelopeIndex] != 0)
                          || (effectEnvelopeHoldIndex[envelopeIndex] != 0)
                          || (effectEnvelopeDecayIndex[envelopeIndex] != 0)
                          || (effectEnvelopeSustainLevel[envelopeIndex] != 0)
                          || (effectEnvelopeReleaseIndex[envelopeIndex] != 0);
  synthEffectEnvelopeActive[envelopeIndex] = envelopeShapeActive && synthEffectAmountDepth(effectEnvelopeAmount[envelopeIndex]) != 0;
}

void updateEffectEnvelopeParamsFromSettings() {
  for (uint8_t envelopeIndex = 0; envelopeIndex < SYNTH_FX_ENVELOPE_COUNT; ++envelopeIndex) {
    updateEffectEnvelopeParamsFromSettings(envelopeIndex);
  }
}
/*
    This defines which hardware alarm
    and interrupt address are used
    to time the call of the poll() function.
  */
#define ALARM_NUM 2
#define ALARM_IRQ TIMER_IRQ_2
/*
    A basic EQ level can be stored to perform
    simple loudness adjustments at certain
    frequencies where human hearing is sensitive.

    By default it's off but you can change this
    flag to "true" to enable it. This may also
    be moved to a Advanced menu option.
  */
#define EQUAL_LOUDNESS_ADJUST true
/*
    This class defines a virtual oscillator.
    It stores an oscillation frequency in
    the form of an increment value, which is
    how much a counter would have to be increased
    every time the poll() interval is reached,
    such that the high 16 bits of the phase counter
    loop across the waveform at the right frequency.

    The value of the counter is useful for reading
    a waveform sample, so that an analog signal
    can be emulated by reading the sample at each
    poll() based on how far the phase has moved
    through one waveform cycle.
  */
class oscillator {
public:
  uint32_t increment = 0;        // current Q16.16 phase increment smoothed by the audio renderer
  uint32_t targetIncrement = 0;  // target Q16.16 phase increment from the control path
  uint32_t counter = 0;          // Q16.16 phase accumulator; high 16 bits are the waveform phase
  uint32_t glideStep = 0;        // linear portamento step in Q16.16 increment units
  uint32_t glideSamplesRemaining = 0;
  byte a = 127;
  byte b = 128;
  byte c = 255;
  uint16_t ab = 0;
  uint16_t cd = 0;
  byte eq = 0;
};
oscillator synth[POLYPHONY_LIMIT];  // maximum polyphony
std::queue<byte> synthChQueue;
byte attenuation[] = { 64, 24, 17, 14, 12, 11, 10, 9, 8 };  // RAM-resident; read by poll() every audio tick.
uint16_t synthModValueQ8 = 0;
uint32_t synthVibratoPhase = 0;
uint32_t synthVibratoPhaseIncrement = synthVibratoPhaseIncrementOptions[SYNTH_VIBRATO_SPEED_DEFAULT];
uint32_t synthLfoPhase = 0;
uint32_t synthLfoPhaseIncrement = synthLfoPhaseIncrementOptions[SYNTH_LFO_SPEED_DEFAULT];
volatile uint16_t metronomeBeepSamplesRemaining = 0;
volatile uint32_t metronomeBeepPhaseIncrement = METRONOME_BEEP_NORMAL_INCREMENT;
uint32_t metronomeBeepPhase = 0;

byte arpeggiatingNow = UNUSED_NOTE;  // if this is 255, set to off (0% duty cycle)
uint64_t arpeggiateTime = 0;         // Used to keep track of when this note started playing in ARPEG mode
uint64_t arpeggiateLength = 62500;   // default: 1/32 note at 120 BPM
constexpr uint16_t ARPEGGIATOR_SEQUENCE_MAX = BTN_COUNT * 2;
std::array<byte, BTN_COUNT> arpeggiatorHeldNotes = {};
uint8_t arpeggiatorHeldNoteCount = 0;
std::array<byte, ARPEGGIATOR_SEQUENCE_MAX> arpeggiatorSequence = {};
uint16_t arpeggiatorSequenceLength = 0;
uint16_t arpeggiatorSequenceCursor = 0;
uint32_t arpeggiatorRandomState = 0xA341316Cu;

inline uint8_t RAM_FUNC(smoothedSynthModValue)(uint8_t elapsedTicks = 1) {
  int16_t targetValue = modWheel.curValue;
  if (targetValue < 0) {
    targetValue = 0;
  } else if (targetValue > 127) {
    targetValue = 127;
  }
  const uint16_t targetQ8 = static_cast<uint16_t>(targetValue) << 8;
  smoothUint16Toward(synthModValueQ8, targetQ8, SYNTH_MOD_SMOOTH_SHIFT, elapsedTicks);
  return static_cast<uint8_t>((synthModValueQ8 + 128u) >> 8);
}

void updateSynthModulationParams() {
  if (synthModTarget > SYNTH_MOD_TARGET_MAX) {
    synthModTarget = SYNTH_MOD_TARGET_MORPH;
  }
  if (synthModAmount > SYNTH_MOD_AMOUNT_FULL) {
    synthModAmount = SYNTH_MOD_AMOUNT_FULL;
  }
  for (uint8_t envelopeIndex = 0; envelopeIndex < SYNTH_FX_ENVELOPE_COUNT; ++envelopeIndex) {
    if (effectEnvelopeTarget[envelopeIndex] > SYNTH_MOD_TARGET_MAX) {
      effectEnvelopeTarget[envelopeIndex] = SYNTH_MOD_TARGET_MORPH;
    }
    if (effectEnvelopeAmount[envelopeIndex] > SYNTH_FX_AMOUNT_FULL) {
      effectEnvelopeAmount[envelopeIndex] = SYNTH_FX_AMOUNT_FULL;
    }
  }
  if (synthVibratoSpeed >= synthVibratoPhaseIncrementOptions.size()) {
    synthVibratoSpeed = SYNTH_VIBRATO_SPEED_DEFAULT;
  }
  synthVibratoPhaseIncrement = synthVibratoPhaseIncrementOptions[synthVibratoSpeed];
  if (synthWavetablePosition > SYNTH_MOD_AMOUNT_FULL) {
    synthWavetablePosition = SYNTH_WAVETABLE_POSITION_DEFAULT;
  }
  if (synthLfoTarget > SYNTH_MOD_TARGET_MAX) {
    synthLfoTarget = SYNTH_MOD_TARGET_MORPH;
  }
  if (synthLfoAmount > SYNTH_FX_AMOUNT_FULL) {
    synthLfoAmount = SYNTH_FX_AMOUNT_OFF;
  }
  if (synthLfoWave > SYNTH_LFO_WAVE_MAX) {
    synthLfoWave = SYNTH_LFO_WAVE_SINE;
  }
  if (synthLfoSpeed >= synthLfoPhaseIncrementOptions.size()) {
    synthLfoSpeed = SYNTH_LFO_SPEED_DEFAULT;
  }
  synthLfoPhaseIncrement = synthLfoPhaseIncrementOptions[synthLfoSpeed];
}

void updateSynthPortamentoSettings() {
  if (synthPortamentoTimeIndex >= envelopeTimeMicrosOptions.size()) {
    synthPortamentoTimeIndex = 0;
  }
  synthPortamentoTicks = ticksFromMicros(envelopeTimeMicrosOptions[synthPortamentoTimeIndex]);
}

inline uint8_t RAM_FUNC(scaleSynthModAmount)(uint8_t modValue) {
  if (synthModAmount >= SYNTH_MOD_AMOUNT_FULL) {
    return modValue;
  }
  return static_cast<uint8_t>((static_cast<uint16_t>(modValue) * static_cast<uint16_t>(synthModAmount) + 64u) >> 7);
}

inline int16_t RAM_FUNC(effectEnvelopeModValue)(uint8_t envelopeIndex, uint8_t target, const EnvelopeState& env) {
  int16_t depth = synthEffectAmountDepth(effectEnvelopeAmount[envelopeIndex]);
  if (depth == 0) {
    return 0;
  }
  bool negativeVibrato = target == SYNTH_MOD_TARGET_VIBRATO && depth < 0;
  if (env.stage == EnvelopeStage::Idle && !negativeVibrato) {
    return 0;
  }

  uint32_t level = env.level;
  if (level > envelopeMaxLevel) {
    level = envelopeMaxLevel;
  }
  uint32_t value = (level + ENVELOPE_MOD_VALUE_ROUND) >> ENVELOPE_MOD_VALUE_SHIFT;
  if (value > 127) {
    value = 127;
  }

  uint8_t absDepth = static_cast<uint8_t>(depth > 0 ? depth : -depth);
  uint8_t scaled = synthFxModScaleByDepth[absDepth][value];
  if (negativeVibrato) {
    return static_cast<int16_t>(absDepth - scaled);
  }
  int16_t signedValue = static_cast<int16_t>(scaled);
  return (depth < 0) ? -signedValue : signedValue;
}

inline void RAM_FUNC(resetCachedEffectEnvelopeModValue)(uint8_t envelopeIndex, uint8_t voiceIndex) {
  cachedEffectEnvelopeModValues[envelopeIndex][voiceIndex] = 0;
}

inline void RAM_FUNC(startEffectEnvelopeAttack)(uint8_t envelopeIndex, EnvelopeState& env) {
  EnvelopeParams& params = effectEnvelopeParams[envelopeIndex];
  env.releaseIncrement = 0;
  env.holdTicksRemaining = 0;
  if (params.attackTicks == 0) {
    advanceEnvelopeFromAttackPeak(params, env);
  } else {
    env.stage = EnvelopeStage::Attack;
    env.level = 0;
  }
}

inline void RAM_FUNC(startEffectEnvelopeRelease)(uint8_t envelopeIndex, EnvelopeState& env) {
  EnvelopeParams& params = effectEnvelopeParams[envelopeIndex];
  if (params.releaseTicks == 0 || env.level == 0) {
    resetEnvelopeState(env);
    return;
  }
  env.stage = EnvelopeStage::Release;
  env.releaseIncrement = effectReleaseIncrementForLevel(envelopeIndex, env.level);
}

inline void RAM_FUNC(updateEffectEnvelopeState)(uint8_t envelopeIndex, EnvelopeState& env, uint8_t elapsedTicks = 1) {
  EnvelopeParams& params = effectEnvelopeParams[envelopeIndex];
  uint32_t tickScale = elapsedTicks ? elapsedTicks : 1;
  switch (env.stage) {
    case EnvelopeStage::Attack: {
      uint32_t increment = params.attackIncrement * tickScale;
      uint32_t nextLevel = env.level + increment;
      if (env.level >= envelopeMaxLevel || nextLevel >= envelopeMaxLevel) {
        advanceEnvelopeFromAttackPeak(params, env);
      } else {
        env.level = nextLevel;
      }
      break;
    }
    case EnvelopeStage::Hold:
      env.level = envelopeMaxLevel;
      if (env.holdTicksRemaining > tickScale) {
        env.holdTicksRemaining -= tickScale;
      } else {
        env.holdTicksRemaining = 0;
        if (params.decayTicks == 0 || params.sustainLevel >= envelopeMaxLevel) {
          env.stage = EnvelopeStage::Sustain;
          env.level = params.sustainLevel;
        } else {
          env.stage = EnvelopeStage::Decay;
        }
      }
      break;
    case EnvelopeStage::Decay:
      if (params.decayTicks == 0 || params.sustainLevel >= envelopeMaxLevel) {
        env.stage = EnvelopeStage::Sustain;
        env.level = params.sustainLevel;
      } else if (env.level > params.sustainLevel) {
        uint32_t decrement = params.decayIncrement * tickScale;
        uint32_t nextLevel = (env.level > decrement) ? (env.level - decrement) : 0;
        if (nextLevel <= params.sustainLevel) {
          env.level = params.sustainLevel;
          env.stage = EnvelopeStage::Sustain;
        } else {
          env.level = nextLevel;
        }
      } else {
        env.level = params.sustainLevel;
        env.stage = EnvelopeStage::Sustain;
      }
      break;
    case EnvelopeStage::Sustain:
      env.level = params.sustainLevel;
      break;
    case EnvelopeStage::Release: {
      uint32_t releaseDecrement = static_cast<uint32_t>(env.releaseIncrement) * tickScale;
      if (params.releaseTicks == 0 || env.releaseIncrement == 0 || env.level <= releaseDecrement) {
        resetEnvelopeState(env);
      } else {
        env.level -= releaseDecrement;
      }
      break;
    }
    case EnvelopeStage::Idle:
    default:
      env.level = 0;
      break;
  }
}

inline void RAM_FUNC(refreshCachedEffectEnvelopeModValue)(uint8_t envelopeIndex,
                                                          uint8_t voiceIndex,
                                                          uint8_t elapsedTicks) {
  if (!synthEffectEnvelopeActive[envelopeIndex]) {
    resetCachedEffectEnvelopeModValue(envelopeIndex, voiceIndex);
    return;
  }
  EnvelopeState& effectEnv = effectEnvelopeStates[envelopeIndex][voiceIndex];
  if (elapsedTicks != 0) {
    updateEffectEnvelopeState(envelopeIndex, effectEnv, elapsedTicks);
  }
  cachedEffectEnvelopeModValues[envelopeIndex][voiceIndex] =
    effectEnvelopeModValue(envelopeIndex, effectEnvelopeTarget[envelopeIndex], effectEnv);
}

inline uint32_t RAM_FUNC(applySynthVibrato)(uint32_t increment, int16_t vibratoAmount) {
  if (vibratoAmount == 0) {
    return increment;
  }

  int32_t offset = (static_cast<int32_t>(increment >> 16) * static_cast<int32_t>(vibratoAmount)) >> 2;
  if (offset < 0) {
    uint32_t negativeOffset = static_cast<uint32_t>(-offset);
    return (negativeOffset >= increment) ? 0 : (increment - negativeOffset);
  }

  uint32_t positiveOffset = static_cast<uint32_t>(offset);
  if (std::numeric_limits<uint32_t>::max() - increment < positiveOffset) {
    return std::numeric_limits<uint32_t>::max();
  }
  return increment + positiveOffset;
}

inline uint16_t RAM_FUNC(applySynthMorphPhaseWarp)(uint16_t phase, int16_t morphAmount) {
  uint16_t triangle = (phase & 0x8000) ? static_cast<uint16_t>(0xFFFFu - phase) : phase;
  uint16_t depth = static_cast<uint16_t>(morphAmount < 0 ? -morphAmount : morphAmount);
  uint16_t offset = static_cast<uint16_t>((static_cast<uint32_t>(triangle) * synthMorphPhaseWarpScaleByDepth[depth]) >> 8);
  return (morphAmount < 0) ? static_cast<uint16_t>(phase - offset)
                           : static_cast<uint16_t>(phase + offset);
}

inline uint16_t RAM_FUNC(applySynthMorphPhaseWarp)(uint16_t phase, int16_t morphAmount, uint16_t morphScale) {
  if (morphAmount == 0 || morphScale == 0) {
    return phase;
  }
  uint16_t triangle = (phase & 0x8000) ? static_cast<uint16_t>(0xFFFFu - phase) : phase;
  uint16_t offset = static_cast<uint16_t>((static_cast<uint32_t>(triangle) * morphScale) >> 8);
  return (morphAmount < 0) ? static_cast<uint16_t>(phase - offset)
                           : static_cast<uint16_t>(phase + offset);
}

inline uint16_t RAM_FUNC(readTriangleWaveSample)(uint16_t phase) {
  if (phase < 0x4000u) {
    return static_cast<uint16_t>(0x8000u + (phase << 1));
  }
  if (phase < 0xC000u) {
    return static_cast<uint16_t>(0xFFFFu - ((phase - 0x4000u) << 1));
  }
  return static_cast<uint16_t>((phase - 0xC000u) << 1);
}

inline uint16_t RAM_FUNC(readSquareWaveSample)(uint16_t phase) {
  constexpr int32_t split = 32768;
  if (phase == 0) {
    return 32768;
  }
  uint16_t shiftedPhase = static_cast<uint16_t>(phase + static_cast<uint16_t>(split));
  return (static_cast<int32_t>(shiftedPhase) > split) ? 65535 : 0;
}

inline uint16_t RAM_FUNC(readHybridWaveSample)(const oscillator& voice, uint8_t phaseIndex) {
  uint8_t rampWidth = (voice.b > voice.a) ? static_cast<uint8_t>(voice.b - voice.a) : 0;
  uint8_t crossingOffset = (rampWidth > 1) ? (rampWidth / 2) : 1;
  uint8_t crossingIndex = static_cast<uint8_t>(voice.a + crossingOffset);
  uint8_t t = static_cast<uint8_t>(phaseIndex + crossingIndex);
  if (phaseIndex == 0) {
    return 32768;
  }
  if (t <= voice.a) {
    return 0;
  }
  if (t < voice.b) {
    return static_cast<uint16_t>((t - voice.a) * voice.ab);
  }
  if (t <= voice.c) {
    return 65535;
  }
  return static_cast<uint16_t>((256 - t) * voice.cd);
}

inline uint8_t sample16ToWaveByte(uint16_t sample) {
  return static_cast<uint8_t>(sample >> 8);
}

bool isValidSynthWaveform(byte waveform) {
  return waveform <= WAVEFORM_CLARINET
      || (waveform >= WAVEFORM_HYBRID && waveform <= WAVEFORM_USER_WAVETABLE);
}

const byte* synthWaveformSource(byte waveform) {
  switch (waveform) {
    case WAVEFORM_SINE: return waveSineSource;
    case WAVEFORM_STRINGS: return waveStringsSource;
    case WAVEFORM_CLARINET: return waveClarinetSource;
    case WAVEFORM_MP: return mpWaveMpSource;
    case WAVEFORM_MP_BOX_SAW: return mpWaveBoxSawSource;
    case WAVEFORM_MP_FRIENDLY_SQUARE: return mpWaveFriendlySquareSource;
    case WAVEFORM_MP_GLASSY: return mpWaveGlassySource;
    case WAVEFORM_MP_KOOLAID: return mpWaveKoolaidSource;
    case WAVEFORM_MP_MERV: return mpWaveMervSource;
    case WAVEFORM_MP_M_BELLISH: return mpWaveMBellishSource;
    case WAVEFORM_MP_OVAL: return mpWaveOvalSource;
    case WAVEFORM_MP_PRETTY_SHAPE: return mpWavePrettyShapeSource;
    case WAVEFORM_MP_QUICK_808: return mpWaveQuick808Source;
    case WAVEFORM_MP_RICH_REPEATER: return mpWaveRichRepeaterSource;
    case WAVEFORM_MP_ROUNDED_TRIANGLE: return mpWaveRoundedTriangleSource;
    case WAVEFORM_MP_STARDEW: return mpWaveStardewSource;
    case WAVEFORM_MP_SYNC_THE_TITANIC: return mpWaveSyncTheTitanicSource;
    case WAVEFORM_MP_WEIRD_WIZARD: return mpWaveWeirdWizardSource;
    case WAVEFORM_MP_WOO: return mpWaveWooSource;
    default: return nullptr;
  }
}

uint8_t readBasicWavetableAnchorSample(uint8_t anchor, uint16_t sampleIndex) {
  uint16_t phase = synthWavePhaseFromSampleIndex(sampleIndex);
  switch (anchor) {
    case 0:
      return waveSineSource[sampleIndex];
    case 1:
      return sample16ToWaveByte(readTriangleWaveSample(phase));
    case 2:
      return sample16ToWaveByte(static_cast<uint16_t>(phase + 32768u));
    case 3:
    default:
      return sample16ToWaveByte(readSquareWaveSample(phase));
  }
}

void fillGeneratedWaveFrame(byte waveform, uint8_t frameIndex) {
  byte* frame = activeSynthWaveTable[frameIndex];
  for (uint16_t sampleIndex = 0; sampleIndex < SYNTH_WAVE_SAMPLE_COUNT; ++sampleIndex) {
    uint16_t phase = synthWavePhaseFromSampleIndex(sampleIndex);
    switch (waveform) {
      case WAVEFORM_SQUARE:
        frame[sampleIndex] = sample16ToWaveByte(readSquareWaveSample(phase));
        break;
      case WAVEFORM_SAW:
        frame[sampleIndex] = sample16ToWaveByte(static_cast<uint16_t>(phase + 32768u));
        break;
      case WAVEFORM_TRIANGLE:
        frame[sampleIndex] = sample16ToWaveByte(readTriangleWaveSample(phase));
        break;
      case WAVEFORM_HYBRID:
      default:
        frame[sampleIndex] = waveSineSource[sampleIndex];
        break;
    }
  }
}

void generateBasicSynthWavetable() {
  constexpr uint8_t anchorCount = 4;
  constexpr uint16_t lastAnchorPosition = (anchorCount - 1) << 8;
  for (uint8_t frameIndex = 0; frameIndex < SYNTH_WAVETABLE_FRAME_COUNT; ++frameIndex) {
    if (frameIndex == SYNTH_WAVETABLE_LAST_FRAME) {
      for (uint16_t sampleIndex = 0; sampleIndex < SYNTH_WAVE_SAMPLE_COUNT; ++sampleIndex) {
        activeSynthWaveTable[frameIndex][sampleIndex] = readBasicWavetableAnchorSample(anchorCount - 1, sampleIndex);
      }
      continue;
    }
    uint16_t anchorPosition = static_cast<uint16_t>(
      (static_cast<uint32_t>(frameIndex) * lastAnchorPosition) / SYNTH_WAVETABLE_LAST_FRAME
    );
    uint8_t anchorA = static_cast<uint8_t>(anchorPosition >> 8);
    uint8_t frameFrac = static_cast<uint8_t>(anchorPosition & 0xFF);
    uint8_t anchorB = static_cast<uint8_t>(anchorA + 1);
    for (uint16_t sampleIndex = 0; sampleIndex < SYNTH_WAVE_SAMPLE_COUNT; ++sampleIndex) {
      uint8_t sampleA = readBasicWavetableAnchorSample(anchorA, sampleIndex);
      uint8_t sampleB = readBasicWavetableAnchorSample(anchorB, sampleIndex);
      int16_t delta = static_cast<int16_t>(sampleB) - static_cast<int16_t>(sampleA);
      activeSynthWaveTable[frameIndex][sampleIndex] =
        static_cast<uint8_t>(static_cast<int16_t>(sampleA) + ((delta * static_cast<int16_t>(frameFrac)) >> 8));
    }
  }
}

void loadFallbackUserSynthWavetable() {
  memcpy(activeSynthWaveTable[0], waveSineSource, SYNTH_WAVE_SAMPLE_COUNT);
  userSynthWavetableAvailable = false;
}

void rebuildSynthWavetableFramePositionLookup(uint8_t frameCount) {
  uint8_t boundedFrameCount = frameCount;
  if (boundedFrameCount < 1) {
    boundedFrameCount = 1;
  } else if (boundedFrameCount > SYNTH_WAVETABLE_FRAME_COUNT) {
    boundedFrameCount = SYNTH_WAVETABLE_FRAME_COUNT;
  }

  uint16_t lastFrame = static_cast<uint16_t>(boundedFrameCount - 1);
  for (uint8_t amount = 0; amount < 128; ++amount) {
    synthWavetableFramePositionByAmount[amount] =
      lastFrame == 0 ? 0 : static_cast<uint16_t>((static_cast<uint32_t>(amount) * lastFrame * 256u) / 127u);
  }
}

void setActiveSynthWaveFrameCount(uint8_t frameCount) {
  uint8_t boundedFrameCount = frameCount;
  if (boundedFrameCount < 1) {
    boundedFrameCount = 1;
  } else if (boundedFrameCount > SYNTH_WAVETABLE_FRAME_COUNT) {
    boundedFrameCount = SYNTH_WAVETABLE_FRAME_COUNT;
  }
  rebuildSynthWavetableFramePositionLookup(boundedFrameCount);
  __dmb();
  activeSynthWaveFrameCount = boundedFrameCount;
}

void initializeSynthMorphLookup() {
  for (uint8_t depth = 0; depth < 128; ++depth) {
    synthMorphPhaseWarpScaleByDepth[depth] = static_cast<uint16_t>(depth) * 5u;
  }
}

void initializeSynthFxModLookup() {
  for (uint8_t depth = 0; depth < 128; ++depth) {
    for (uint8_t value = 0; value < 128; ++value) {
      synthFxModScaleByDepth[depth][value] = static_cast<uint8_t>((static_cast<uint16_t>(value) * (static_cast<uint16_t>(depth) + 1u)) >> 7);
    }
  }
}

void initializeSynthWaveTables() {
  memcpy(synthVibratoSine, waveSineSource, SYNTH_WAVE_SAMPLE_COUNT);
  initializeSynthMorphLookup();
  initializeSynthFxModLookup();
  setActiveSynthWaveFrameCount(1);
  resetSynthRenderCaches();
  loadedSynthWaveform = 255;
}

void loadSelectedSynthWaveform() {
  if (!isValidSynthWaveform(currWave)) {
    currWave = WAVEFORM_HYBRID;
  }
  if (loadedSynthWaveform == currWave) {
    return;
  }

  synthWaveTableLoadInProgress = true;
  if (currWave == WAVEFORM_BASIC_WAVETABLE) {
    generateBasicSynthWavetable();
    setActiveSynthWaveFrameCount(SYNTH_WAVETABLE_FRAME_COUNT);
  } else if (currWave == WAVEFORM_USER_WAVETABLE) {
    if (!loadUserSynthWavetableFromFile()) {
      loadFallbackUserSynthWavetable();
      setActiveSynthWaveFrameCount(1);
    }
  } else {
    const byte* source = synthWaveformSource(currWave);
    if (source) {
      memcpy(activeSynthWaveTable[0], source, SYNTH_WAVE_SAMPLE_COUNT);
    } else {
      fillGeneratedWaveFrame(currWave, 0);
    }
    setActiveSynthWaveFrameCount(1);
  }
  loadedSynthWaveform = currWave;
  resetSynthRenderCaches();
  synthWaveTableLoadInProgress = false;
}

inline uint16_t RAM_FUNC(wavetableFramePositionFromAmount)(int16_t positionAmount) {
  if (positionAmount <= 0) {
    return 0;
  }
  uint8_t amount = positionAmount > 127 ? 127 : static_cast<uint8_t>(positionAmount);
  return synthWavetableFramePositionByAmount[amount];
}

inline uint16_t RAM_FUNC(readLoadedWaveFrameSample)(uint16_t phase) {
  return static_cast<uint16_t>(activeSynthWaveTable[0][synthWaveSampleIndexFromPhase16(phase)] << 8);
}

struct SynthWavetableReadContext {
  const byte* frameA;
  const byte* frameB;
  uint8_t frameFrac;
};

struct SynthModulationAmounts {
  int16_t morph = 0;
  int16_t vibrato = 0;
  int16_t pitch = 0;
  int16_t wavetablePosition = 0;
};

struct SynthVoiceRenderCache {
  uint32_t phaseIncrement = 0;
  int16_t morphAmount = 0;
  uint16_t morphScale = 0;
  SynthWavetableReadContext wavetableContext = { activeSynthWaveTable[0], nullptr, 0 };
};

SynthModulationAmounts synthBaseModulationCache = {};
std::array<SynthVoiceRenderCache, POLYPHONY_LIMIT> synthVoiceRenderCaches = {};
std::array<bool, POLYPHONY_LIMIT> synthVoiceRenderCacheValid = {};
SynthWavetableReadContext synthSharedWavetableReadContext = { activeSynthWaveTable[0], nullptr, 0 };
uint8_t synthControlSampleCountdown = 0;

inline void RAM_FUNC(resetSynthVoiceRenderCache)(uint8_t voiceIndex) {
  if (voiceIndex >= POLYPHONY_LIMIT) {
    return;
  }
  synthVoiceRenderCaches[voiceIndex] = {};
  synthVoiceRenderCacheValid[voiceIndex] = false;
}

void RAM_FUNC(resetSynthRenderCaches)() {
  synthBaseModulationCache = {};
  synthSharedWavetableReadContext = { activeSynthWaveTable[0], nullptr, 0 };
  synthControlSampleCountdown = 0;
  for (uint8_t voiceIndex = 0; voiceIndex < POLYPHONY_LIMIT; ++voiceIndex) {
    resetSynthVoiceRenderCache(voiceIndex);
  }
}

inline SynthWavetableReadContext RAM_FUNC(wavetableReadContextFromFramePosition)(uint16_t framePosition,
                                                                                 uint8_t frameCount) {
  if (frameCount <= 1) {
    return { activeSynthWaveTable[0], nullptr, 0 };
  }

  uint8_t frameIndex = static_cast<uint8_t>(framePosition >> 8);
  uint8_t frameFrac = static_cast<uint8_t>(framePosition & 0xFF);
  uint8_t maxFrameIndex = static_cast<uint8_t>(frameCount - 1);
  if (frameIndex >= maxFrameIndex) {
    return { activeSynthWaveTable[maxFrameIndex], nullptr, 0 };
  }
  if (frameFrac == 0) {
    return { activeSynthWaveTable[frameIndex], nullptr, 0 };
  }
  return { activeSynthWaveTable[frameIndex], activeSynthWaveTable[frameIndex + 1], frameFrac };
}

inline uint16_t RAM_FUNC(readActiveWavetableSampleWithContext)(uint16_t phase,
                                                               const SynthWavetableReadContext& context) {
  uint16_t sampleIndex = synthWaveSampleIndexFromPhase16(phase);
  int16_t sampleA = context.frameA[sampleIndex];
  if (!context.frameB) {
    return static_cast<uint16_t>(sampleA << 8);
  }
  int16_t sampleB = context.frameB[sampleIndex];
  return static_cast<uint16_t>((sampleA << 8) + ((sampleB - sampleA) * static_cast<int16_t>(context.frameFrac)));
}

inline uint16_t RAM_FUNC(readActiveWavetableSampleAtFramePosition)(uint16_t phase,
                                                                   uint16_t framePosition,
                                                                   uint8_t frameCount) {
  return readActiveWavetableSampleWithContext(phase, wavetableReadContextFromFramePosition(framePosition, frameCount));
}

inline uint16_t RAM_FUNC(readActiveWavetableSample)(uint16_t phase,
                                                    int16_t positionAmount,
                                                    uint8_t frameCount) {
  return readActiveWavetableSampleAtFramePosition(phase, wavetableFramePositionFromAmount(positionAmount), frameCount);
}

inline int16_t RAM_FUNC(clampSynthModAccumulator)(int16_t value) {
  if (value > 127) {
    return 127;
  }
  if (value < -127) {
    return -127;
  }
  return value;
}

inline int16_t RAM_FUNC(combinedWavetablePositionAmount)(int16_t positionModAmount) {
  int16_t amount = static_cast<int16_t>(synthWavetablePosition) + positionModAmount;
  if (amount > 127) {
    return 127;
  }
  if (amount < 0) {
    return 0;
  }
  return amount;
}

inline int16_t RAM_FUNC(readSynthLfoSample)() {
  uint16_t sinePhase = synthWaveSampleIndexFromPhase32(synthLfoPhase);
  uint8_t phase = synthLfoPhase >> 24;
  switch (synthLfoWave) {
    case SYNTH_LFO_WAVE_TRIANGLE:
      if (phase < 64) {
        return static_cast<int16_t>(phase * 2);
      }
      if (phase < 128) {
        return static_cast<int16_t>(127 - ((phase - 64) * 2));
      }
      if (phase < 192) {
        return static_cast<int16_t>(-((phase - 128) * 2));
      }
      return static_cast<int16_t>(-127 + ((phase - 192) * 2));
    case SYNTH_LFO_WAVE_SAW:
      return static_cast<int16_t>(phase) - 128;
    case SYNTH_LFO_WAVE_SQUARE:
      return (phase < 128) ? 127 : -127;
    case SYNTH_LFO_WAVE_SINE:
    default:
      return static_cast<int16_t>(synthVibratoSine[sinePhase]) - 128;
  }
}

inline int16_t RAM_FUNC(synthLfoModValue)(uint8_t elapsedTicks = 1) {
  int16_t depth = synthEffectAmountDepth(synthLfoAmount);
  if (depth == 0) {
    return 0;
  }
  synthLfoPhase += synthLfoPhaseIncrement * static_cast<uint32_t>(elapsedTicks ? elapsedTicks : 1);
  int16_t sample = readSynthLfoSample();
  int32_t scaled = static_cast<int32_t>(sample) * static_cast<int32_t>(depth);
  return static_cast<int16_t>(scaled >> 7);
}

inline void RAM_FUNC(addSynthTargetAmount)(uint8_t target,
                                           int16_t amount,
                                           int16_t& morphAmount,
                                           int16_t& vibratoAmount,
                                           int16_t& pitchAmount,
                                           int16_t& wavetablePositionAmount) {
  if (amount == 0) {
    return;
  }
  int16_t* destination = nullptr;
  switch (target) {
    case SYNTH_MOD_TARGET_MORPH:
      destination = &morphAmount;
      break;
    case SYNTH_MOD_TARGET_VIBRATO:
      destination = &vibratoAmount;
      break;
    case SYNTH_MOD_TARGET_PITCH:
      destination = &pitchAmount;
      break;
    case SYNTH_MOD_TARGET_WAVETABLE_POSITION:
      destination = &wavetablePositionAmount;
      break;
    default:
      return;
  }
  *destination = clampSynthModAccumulator(static_cast<int16_t>(*destination + amount));
}

constexpr uint32_t RAM_FUNC(SYNTH_PITCH_MOD_POSITIVE_Q16)[128] = {
  65536, 66982, 68461, 69972, 71516, 73095, 74708, 76357,
  78042, 79765, 81525, 83325, 85164, 87043, 88965, 90928,
  92935, 94986, 97083, 99226, 101416, 103654, 105942, 108280,
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  899976, 919840, 940142, 960893, 982101, 1003777, 1025932, 1048576
};

constexpr uint32_t RAM_FUNC(SYNTH_PITCH_MOD_NEGATIVE_Q16)[128] = {
  65536, 64121, 62736, 61381, 60056, 58759, 57490, 56249,
  55034, 53845, 52683, 51545, 50432, 49343, 48277, 47235,
  46215, 45217, 44240, 43285, 42350, 41436, 40541, 39665,
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  4772, 4669, 4568, 4470, 4373, 4279, 4186, 4096
};

inline uint32_t RAM_FUNC(applySynthPitchMod)(uint32_t increment, int16_t pitchAmount) {
  if (pitchAmount == 0) {
    return increment;
  }
  uint8_t depth = pitchAmount > 0 ? static_cast<uint8_t>(pitchAmount)
                                  : static_cast<uint8_t>(-pitchAmount);
  uint32_t ratioQ16 = pitchAmount > 0 ? SYNTH_PITCH_MOD_POSITIVE_Q16[depth]
                                      : SYNTH_PITCH_MOD_NEGATIVE_Q16[depth];
  uint64_t scaled = (static_cast<uint64_t>(increment) * ratioQ16) >> 16;
  if (scaled > std::numeric_limits<uint32_t>::max()) {
    return std::numeric_limits<uint32_t>::max();
  }
  return static_cast<uint32_t>(scaled);
}

inline bool RAM_FUNC(synthControlTickDue)() {
  if (synthControlSampleCountdown == 0) {
    synthControlSampleCountdown = SYNTH_CONTROL_RATE_SAMPLES - 1;
    return true;
  }
  --synthControlSampleCountdown;
  return false;
}

inline void RAM_FUNC(refreshSynthBaseModulationCache)(uint8_t elapsedTicks) {
  synthBaseModulationCache = {};
  const uint8_t synthModValue = scaleSynthModAmount(smoothedSynthModValue(elapsedTicks));
  addSynthTargetAmount(synthModTarget,
                       synthModValue,
                       synthBaseModulationCache.morph,
                       synthBaseModulationCache.vibrato,
                       synthBaseModulationCache.pitch,
                       synthBaseModulationCache.wavetablePosition);
  addSynthTargetAmount(synthLfoTarget,
                       synthLfoModValue(elapsedTicks),
                       synthBaseModulationCache.morph,
                       synthBaseModulationCache.vibrato,
                       synthBaseModulationCache.pitch,
                       synthBaseModulationCache.wavetablePosition);
}

inline void RAM_FUNC(advanceSynthFrequencyControl)(uint8_t voiceIndex, uint8_t elapsedTicks) {
  if (elapsedTicks == 0) {
    return;
  }

  oscillator& voice = synth[voiceIndex];
  uint8_t remainingTicks = elapsedTicks;
  if (voice.glideSamplesRemaining > 0) {
    uint32_t glideTicks = voice.glideSamplesRemaining < remainingTicks
                            ? voice.glideSamplesRemaining
                            : remainingTicks;
    uint64_t step = static_cast<uint64_t>(voice.glideStep ? voice.glideStep : 1) * glideTicks;
    if (voice.targetIncrement > voice.increment) {
      uint32_t remaining = voice.targetIncrement - voice.increment;
      voice.increment += static_cast<uint32_t>(step >= remaining ? remaining : step);
    } else if (voice.targetIncrement < voice.increment) {
      uint32_t remaining = voice.increment - voice.targetIncrement;
      voice.increment -= static_cast<uint32_t>(step >= remaining ? remaining : step);
    }

    voice.glideSamplesRemaining -= glideTicks;
    remainingTicks = static_cast<uint8_t>(remainingTicks - glideTicks);
    if (voice.glideSamplesRemaining == 0 || voice.increment == voice.targetIncrement) {
      voice.increment = voice.targetIncrement;
      clearSynthPortamento(voiceIndex);
    }
  }

  if (remainingTicks != 0) {
    smoothUint32Toward(voice.increment, voice.targetIncrement, SYNTH_PITCH_SMOOTH_SHIFT, remainingTicks);
  }
}

inline void RAM_FUNC(refreshSynthVoiceRenderCache)(uint8_t voiceIndex,
                                                   uint8_t elapsedTicks,
                                                   bool activeWavetableHasFrames,
                                                   bool perVoiceWavetablePosition,
                                                   uint8_t activeWaveFrameCount,
                                                   bool& synthVibratoSampleReady,
                                                   int16_t& synthVibratoSample) {
  SynthModulationAmounts voiceModulation = synthBaseModulationCache;
  for (uint8_t envelopeIndex = 0; envelopeIndex < SYNTH_FX_ENVELOPE_COUNT; ++envelopeIndex) {
    refreshCachedEffectEnvelopeModValue(envelopeIndex, voiceIndex, elapsedTicks);
    if (synthEffectEnvelopeActive[envelopeIndex]) {
      addSynthTargetAmount(effectEnvelopeTarget[envelopeIndex],
                           cachedEffectEnvelopeModValues[envelopeIndex][voiceIndex],
                           voiceModulation.morph,
                           voiceModulation.vibrato,
                           voiceModulation.pitch,
                           voiceModulation.wavetablePosition);
    }
  }

  advanceSynthFrequencyControl(voiceIndex, elapsedTicks);

  uint32_t phaseIncrement = synth[voiceIndex].increment;
  if (voiceModulation.pitch != 0) {
    phaseIncrement = applySynthPitchMod(phaseIncrement, voiceModulation.pitch);
  }
  if (voiceModulation.vibrato != 0) {
    if (!synthVibratoSampleReady) {
      if (elapsedTicks != 0) {
        synthVibratoPhase += synthVibratoPhaseIncrement * static_cast<uint32_t>(elapsedTicks);
      }
      synthVibratoSample =
        static_cast<int16_t>(synthVibratoSine[synthWaveSampleIndexFromPhase32(synthVibratoPhase)]) - 128;
      synthVibratoSampleReady = true;
    }
    int16_t voiceVibratoAmount = synthVibratoSample * voiceModulation.vibrato;
    if (voiceVibratoAmount != 0) {
      phaseIncrement = applySynthVibrato(phaseIncrement, voiceVibratoAmount);
    }
  }

  SynthVoiceRenderCache& cache = synthVoiceRenderCaches[voiceIndex];
  cache.phaseIncrement = phaseIncrement;
  cache.morphAmount = voiceModulation.morph;
  uint16_t morphDepth = static_cast<uint16_t>(voiceModulation.morph < 0 ? -voiceModulation.morph : voiceModulation.morph);
  cache.morphScale = (morphDepth == 0) ? 0 : synthMorphPhaseWarpScaleByDepth[morphDepth];
  if (activeWavetableHasFrames) {
    cache.wavetableContext = perVoiceWavetablePosition
                               ? wavetableReadContextFromFramePosition(
                                   wavetableFramePositionFromAmount(
                                     combinedWavetablePositionAmount(voiceModulation.wavetablePosition)),
                                   activeWaveFrameCount)
                               : synthSharedWavetableReadContext;
  } else {
    cache.wavetableContext = { activeSynthWaveTable[0], nullptr, 0 };
  }
  synthVoiceRenderCacheValid[voiceIndex] = true;
}

inline int32_t RAM_FUNC(readMetronomeBeepSample)() {
  uint16_t remaining = metronomeBeepSamplesRemaining;
  if (remaining == 0) {
    return 0;
  }

  metronomeBeepSamplesRemaining = remaining - 1;
  metronomeBeepPhase += metronomeBeepPhaseIncrement;
  int32_t sample = (metronomeBeepPhase & 0x80000000u) ? METRONOME_BEEP_LEVEL : -METRONOME_BEEP_LEVEL;
  return (sample * static_cast<int32_t>(velWheel.curValue)) >> 7;
}

inline bool RAM_FUNC(metronomeBrightnessSelected)() {
  return metronomeMode == METRONOME_MODE_BRIGHTNESS;
}

inline bool RAM_FUNC(metronomeSideButtonsSelected)() {
  return metronomeMode == METRONOME_MODE_SIDE_BUTTONS;
}

inline bool RAM_FUNC(metronomeBeepSelected)() {
  return metronomeMode == METRONOME_MODE_BEEP;
}

inline bool RAM_FUNC(metronomeEnabled)() {
  return metronomeMode != METRONOME_MODE_OFF;
}

inline bool RAM_FUNC(metronomeVisualFlashActive)() {
  return (metronomeBrightnessSelected() || metronomeSideButtonsSelected()) && runTime < metronomeVisualFlashUntil;
}

void RAM_FUNC(resetMetronomeState)() {
  metronomeBeatCursor = 0;
  metronomeNextBeatTime = 0;
  metronomeVisualFlashUntil = 0;
  metronomeAccent = false;
  metronomeBeepSamplesRemaining = 0;
}

void updateMetronomeTiming() {
  if (metronomeMode > METRONOME_MODE_SIDE_BUTTONS) {
    metronomeMode = METRONOME_MODE_OFF;
  }
  if (metronomeSignatureIndex >= METRONOME_SIGNATURE_COUNT) {
    metronomeSignatureIndex = 0;
  }

  const MetronomeSignature& signature = metronomeSignatures[metronomeSignatureIndex];
  metronomeBeatsPerMeasure = signature.beats ? signature.beats : 1;
  uint8_t noteValue = signature.noteValue ? signature.noteValue : 4;

  uint32_t bpm = synthBPM;
  if (bpm == 0) {
    bpm = 1;
  }
  uint64_t wholeNoteMicros = (240000000ULL + (bpm / 2)) / bpm;
  metronomeBeatIntervalMicros = (wholeNoteMicros + (noteValue / 2)) / noteValue;
  if (metronomeBeatIntervalMicros == 0) {
    metronomeBeatIntervalMicros = 1;
  }
  resetMetronomeState();
}

void RAM_FUNC(triggerMetronomeBeat)(bool accent) {
  constexpr uint64_t METRONOME_VISUAL_FLASH_MICROS = 125000;
  metronomeAccent = accent;

  if (metronomeBrightnessSelected() || metronomeSideButtonsSelected()) {
    metronomeVisualFlashUntil = runTime + METRONOME_VISUAL_FLASH_MICROS;
  }
  if (metronomeBeepSelected()) {
    metronomeBeepPhaseIncrement = accent ? METRONOME_BEEP_ACCENT_INCREMENT : METRONOME_BEEP_NORMAL_INCREMENT;
    metronomeBeepSamplesRemaining = METRONOME_BEEP_SAMPLE_COUNT;
  }
}

void RAM_FUNC(runMetronome)() {
  if (!metronomeEnabled() || delegatedControl) {
    return;
  }

  if (metronomeNextBeatTime == 0) {
    metronomeNextBeatTime = runTime;
  }

  while (runTime >= metronomeNextBeatTime) {
    bool accent = (metronomeBeatCursor == 0);
    triggerMetronomeBeat(accent);
    metronomeBeatCursor = static_cast<uint8_t>((metronomeBeatCursor + 1) % metronomeBeatsPerMeasure);
    metronomeNextBeatTime += metronomeBeatIntervalMicros;
  }
}

void metronomeModeChanged() {
  resetMetronomeState();
}

void updateArpeggiatorTiming() {
  uint32_t bpm = synthBPM;
  if (bpm == 0) {
    bpm = 1;
  }
  uint32_t division = arpeggiatorDivision;
  if (division == 0) {
    division = 1;
  }

  const uint64_t wholeNoteMicros = (240000000ULL + (bpm / 2)) / bpm;  // four quarter notes in microseconds
  arpeggiateLength = (wholeNoteMicros + (division / 2)) / division;
  if (arpeggiateLength == 0) {
    arpeggiateLength = 1;
  }
  updateMetronomeTiming();
}

void updateArpeggiatorDirection() {
  if (arpeggiatorDirection >= ARP_DIRECTION_COUNT) {
    arpeggiatorDirection = ARP_DIRECTION_UP;
  }
  arpeggiatorSequenceCursor = 0;
}

AudioOutputLevels RAM_FUNC(renderAudioOutputLevels)() {
  AudioOutputLevels output;
  if (flashWriteInProgress.load(std::memory_order_relaxed) || synthWaveTableLoadInProgress) {
    return output;
  }
  int32_t mix = 0;    // signed accumulator stays well within int32_t bounds
  const int32_t metronomeSample = readMetronomeBeepSample();
  const bool metronomeAudible = metronomeSample != 0;
  const bool synthControlTick = synthControlTickDue();
  if (synthControlTick) {
    refreshSynthBaseModulationCache(SYNTH_CONTROL_RATE_SAMPLES);
  }
  int16_t synthVibratoSample = 0;
  bool synthVibratoSampleReady = false;
  // ============================================================
  // Smooth poly loudness normalization
  // Old behavior: scale by integer "voices" count.
  // Problem: when a voice fades out and becomes inactive, voices--
  // causes a sudden gain jump (audible).
  //
  // New behavior: compute an "effective voice count" from the sum of
  // envelope levels. As a voice releases, its envelope contribution
  // smoothly approaches 0, so the normalization changes smoothly too.
  // ============================================================
  uint32_t envSum = 0;   // sum of audible envelope levels across active voices (0..8*65535)
  byte voices = 0;
  uint8_t profileFlags = 0;

  uint16_t p;
  byte t;
  const uint8_t voiceLimit = currentSynthVoiceLimit();
  const uint8_t activeWaveFrameCount = activeSynthWaveFrameCount;
  const bool activeWavetableHasFrames = activeWaveFrameCount > 1;
  const bool perVoiceWavetablePosition =
    activeWavetableHasFrames
    && ((synthEffectEnvelopeActive[0] && effectEnvelopeTarget[0] == SYNTH_MOD_TARGET_WAVETABLE_POSITION)
        || (synthEffectEnvelopeActive[1] && effectEnvelopeTarget[1] == SYNTH_MOD_TARGET_WAVETABLE_POSITION));
  if (synthControlTick) {
    synthSharedWavetableReadContext =
      (activeWavetableHasFrames && !perVoiceWavetablePosition)
        ? wavetableReadContextFromFramePosition(
            wavetableFramePositionFromAmount(
              combinedWavetablePositionAmount(synthBaseModulationCache.wavetablePosition)),
            activeWaveFrameCount)
        : SynthWavetableReadContext{ activeSynthWaveTable[0], nullptr, 0 };
  }
  for (byte i = 0; i < voiceLimit; i++) {
    EnvelopeState& env = envelopeStates[i];
    bool forceVoiceRenderCacheRefresh = false;

    EnvelopeCommand pendingCommand = consumeEnvelopeCommand(i);
    switch (pendingCommand) {
      case EnvelopeCommand::StartAttack: {
        resetSynthVoiceRenderCache(i);
        forceVoiceRenderCacheRefresh = true;
        env.releaseIncrement = 0;
        env.holdTicksRemaining = 0;
        if (envelopeParams.attackTicks == 0) {
          advanceEnvelopeFromAttackPeak(envelopeParams, env);
        } else {
          env.stage = EnvelopeStage::Attack;
          env.level = 0;
        }
        for (uint8_t envelopeIndex = 0; envelopeIndex < SYNTH_FX_ENVELOPE_COUNT; ++envelopeIndex) {
          EnvelopeState& effectEnv = effectEnvelopeStates[envelopeIndex][i];
          resetCachedEffectEnvelopeModValue(envelopeIndex, i);
          if (synthEffectEnvelopeActive[envelopeIndex]) {
            startEffectEnvelopeAttack(envelopeIndex, effectEnv);
          } else {
            resetEnvelopeState(effectEnv);
          }
        }
        break;
      }
      case EnvelopeCommand::StartRelease: {
        resetSynthVoiceRenderCache(i);
        forceVoiceRenderCacheRefresh = true;
        releaseRetries[i] = 0;
        releaseRetryCountdown[i] = 0;
        if (envelopeParams.releaseTicks == 0 || env.level == 0) {
          env.level = 0;
          env.stage = EnvelopeStage::Idle;
          synth[i].increment = 0;
          synth[i].targetIncrement = 0;
          synth[i].counter = 0;
          clearSynthPortamento(i);
          resetSynthVoiceRenderCache(i);
          publishVoiceFreed(i);
        } else {
          env.stage = EnvelopeStage::Release;
          profileFlags |= ISR_PROFILE_FLAG_RELEASE_START;
          if (isrProfilingEnabled) {
            isrCycleReleaseStartCount++;
          }
          env.releaseIncrement = releaseIncrementForLevel(env.level);
        }
        for (uint8_t envelopeIndex = 0; envelopeIndex < SYNTH_FX_ENVELOPE_COUNT; ++envelopeIndex) {
          EnvelopeState& effectEnv = effectEnvelopeStates[envelopeIndex][i];
          if (synthEffectEnvelopeActive[envelopeIndex]) {
            startEffectEnvelopeRelease(envelopeIndex, effectEnv);
            if (effectEnv.stage == EnvelopeStage::Idle) {
              resetCachedEffectEnvelopeModValue(envelopeIndex, i);
            }
          } else {
            resetEnvelopeState(effectEnv);
            resetCachedEffectEnvelopeModValue(envelopeIndex, i);
          }
        }
        break;
      }
      case EnvelopeCommand::Reset: {
        resetSynthVoiceRenderCache(i);
        resetEnvelopeState(env);
        for (uint8_t envelopeIndex = 0; envelopeIndex < SYNTH_FX_ENVELOPE_COUNT; ++envelopeIndex) {
          resetEnvelopeState(effectEnvelopeStates[envelopeIndex][i]);
          resetCachedEffectEnvelopeModValue(envelopeIndex, i);
        }
        synth[i].increment = 0;
        synth[i].targetIncrement = 0;
        synth[i].counter = 0;
        clearSynthPortamento(i);
        channelInUse[i].store(false, std::memory_order_relaxed);
        voiceGenerations[i].store(0, std::memory_order_relaxed);
        break;
      }
      case EnvelopeCommand::None:
      default:
        break;
    }

    if (!synth[i].targetIncrement && env.stage == EnvelopeStage::Idle) {
      continue;
    }

    switch (env.stage) {
      case EnvelopeStage::Attack: {
        uint32_t nextLevel = env.level + envelopeParams.attackIncrement;
        if (env.level >= envelopeMaxLevel || nextLevel >= envelopeMaxLevel) {
          advanceEnvelopeFromAttackPeak(envelopeParams, env);
        } else {
          env.level = nextLevel;
        }
        break;
      }
      case EnvelopeStage::Hold:
        updateEnvelopeHoldStage(envelopeParams, env);
        break;
      case EnvelopeStage::Decay:
        if (envelopeParams.decayTicks == 0 || envelopeParams.sustainLevel >= envelopeMaxLevel) {
          env.stage = EnvelopeStage::Sustain;
          env.level = envelopeParams.sustainLevel;
        } else if (env.level > envelopeParams.sustainLevel) {
          uint32_t nextLevel = (env.level > envelopeParams.decayIncrement) ? (env.level - envelopeParams.decayIncrement) : 0;
          if (nextLevel <= envelopeParams.sustainLevel) {
            env.level = envelopeParams.sustainLevel;
            env.stage = EnvelopeStage::Sustain;
          } else {
            env.level = nextLevel;
          }
        } else {
          env.level = envelopeParams.sustainLevel;
          env.stage = EnvelopeStage::Sustain;
        }
        break;
      case EnvelopeStage::Sustain:
        env.level = envelopeParams.sustainLevel;
        break;
      case EnvelopeStage::Release:
        if (envelopeParams.releaseTicks == 0 || env.releaseIncrement == 0 || env.level <= env.releaseIncrement) {
          env.level = 0;
          env.stage = EnvelopeStage::Idle;
          synth[i].increment = 0;
          synth[i].targetIncrement = 0;
          synth[i].counter = 0;
          clearSynthPortamento(i);
          resetSynthVoiceRenderCache(i);
          publishVoiceFreed(i);
        } else {
          env.level -= env.releaseIncrement;
        }
        break;
      case EnvelopeStage::Idle:
      default:
        env.level = 0;
        synth[i].increment = 0;
        synth[i].targetIncrement = 0;
        synth[i].counter = 0;
        clearSynthPortamento(i);
        resetSynthVoiceRenderCache(i);
        for (uint8_t envelopeIndex = 0; envelopeIndex < SYNTH_FX_ENVELOPE_COUNT; ++envelopeIndex) {
          resetEnvelopeState(effectEnvelopeStates[envelopeIndex][i]);
          resetCachedEffectEnvelopeModValue(envelopeIndex, i);
        }
        continue;
    }

    if (env.stage == EnvelopeStage::Idle || env.level == 0 || !synth[i].targetIncrement) {
      continue;
    }

    if (synthControlTick || forceVoiceRenderCacheRefresh || !synthVoiceRenderCacheValid[i]) {
      refreshSynthVoiceRenderCache(i,
                                   (synthControlTick && !forceVoiceRenderCacheRefresh)
                                     ? SYNTH_FX_ENVELOPE_CONTROL_TICKS
                                     : 0,
                                   activeWavetableHasFrames,
                                   perVoiceWavetablePosition,
                                   activeWaveFrameCount,
                                   synthVibratoSampleReady,
                                   synthVibratoSample);
    }
    const SynthVoiceRenderCache& voiceCache = synthVoiceRenderCaches[i];
    synth[i].counter += voiceCache.phaseIncrement;  // high 16 bits loop from 65535 -> 0
    p = static_cast<uint16_t>(synth[i].counter >> 16);
    if (voiceCache.morphAmount != 0) {
      p = applySynthMorphPhaseWarp(p, voiceCache.morphAmount, voiceCache.morphScale);
    }
    if (activeWavetableHasFrames) {
      p = readActiveWavetableSampleWithContext(p, voiceCache.wavetableContext);
    } else {
      t = p >> 8;
      switch (currWave) {
        case WAVEFORM_SAW:
          p = static_cast<uint16_t>(p + 32768);
          break;
        case WAVEFORM_TRIANGLE: p = readTriangleWaveSample(p); break;
        case WAVEFORM_SQUARE: p = readSquareWaveSample(p); break;
        case WAVEFORM_HYBRID: p = readHybridWaveSample(synth[i], t); break;
        case WAVEFORM_SINE:
        case WAVEFORM_BASIC_WAVETABLE:
          p = interpolatedWaveSample(activeSynthWaveTable[0], p);
          break;
        case WAVEFORM_STRINGS:
        case WAVEFORM_CLARINET:
        case WAVEFORM_MP:
        case WAVEFORM_MP_BOX_SAW:
        case WAVEFORM_MP_FRIENDLY_SQUARE:
        case WAVEFORM_MP_GLASSY:
        case WAVEFORM_MP_KOOLAID:
        case WAVEFORM_MP_MERV:
        case WAVEFORM_MP_M_BELLISH:
        case WAVEFORM_MP_OVAL:
        case WAVEFORM_MP_PRETTY_SHAPE:
        case WAVEFORM_MP_QUICK_808:
        case WAVEFORM_MP_RICH_REPEATER:
        case WAVEFORM_MP_ROUNDED_TRIANGLE:
        case WAVEFORM_MP_STARDEW:
        case WAVEFORM_MP_SYNC_THE_TITANIC:
        case WAVEFORM_MP_WEIRD_WIZARD:
        case WAVEFORM_MP_WOO:
        case WAVEFORM_USER_WAVETABLE:
          p = readLoadedWaveFrameSample(p);
          break;
        default: break;
      }
    }

    // Convert unipolar 0..65535 waveform into bipolar signed audio sample.
    // Centering improves headroom and reduces asymmetric clipping.
    int32_t s = (int32_t)p - 32768;  // -32768..+32767

    // Apply crude "equal loudness" compensation.
    // eq is 0..8. Treat 8 as roughly "neutral" gain.
    s = (s * (int32_t)synth[i].eq) >> 3;

    // Apply the audible envelope level (0..65535). The envelope state keeps
    // fractional bits for long times, but the mix multiply stays 32-bit.
    uint32_t envAudio = envelopeAudioLevel(env.level);
    s = (s * static_cast<int32_t>(envAudio)) >> 16;

    // Accumulate signed mix
    mix += s;

    // For Step 1 smooth normalization:
    envSum += envAudio;
    ++voices;
  }

  // Compute effective voices in Q8 (fixed-point, 8 fractional bits).
  // Approximate division by 65535 using >> 8, since 65535 ≈ 65536.
  // Examples:
  //  - 1 full voice: envSum ≈ 65535 => (envSum + 128) >> 8 ≈ 256  => 1.00 voices
  //  - 8 full voices: envSum ≈ 524280 => >> 8 ≈ 2048 => 8.00 voices
  uint16_t effectiveVoicesQ8 = (uint16_t)((envSum + 128u) >> 8);  // 0..2048

  // Convert to table index 0..8 and fractional part for interpolation
  uint8_t vInt = effectiveVoicesQ8 >> 8;          // 0..8
  uint8_t vFrac = effectiveVoicesQ8 & 0xFF;       // 0..255

  if (vInt > 8) vInt = 8;                         // safety

  // Smoothly interpolate attenuation between adjacent entries.
  // attenuation[] is in "64 == full scale" units.
  uint8_t a0 = attenuation[vInt];
  uint8_t a1 = attenuation[(vInt < 8) ? (vInt + 1) : 8];

  // Linear interpolation: a = a0 + (a1 - a0) * frac
  int16_t da = (int16_t)a1 - (int16_t)a0;
  uint16_t attenSmooth = (uint16_t)((int16_t)a0 + ((da * (int16_t)vFrac) >> 8));  // 0..64-ish

  // Only apply this smoothing in poly mode, keep mono behavior the same.
  uint16_t attenFinal = isPolyPlaybackMode(playbackMode) ? attenSmooth : attenuation[0];

  // Apply poly/mono attenuation where 64 = unity.
  // Note: mix is bounded by ±(POLYPHONY_LIMIT * ~256) ≈ ±2048 after envelope,
  // attenFinal ≤ 64, velWheel ≤ 127. Worst-case product ≈ 16.6M, well within int32_t.
  int32_t scaled = mix;
  scaled = (scaled * (int32_t)attenFinal) >> 6;     // divide by 64

  // Apply master volume where 127 ~= unity (use >>7 as approx /128)
  scaled = (scaled * (int32_t)velWheel.curValue) >> 7;

  // ============================================================
  // OUTPUT STAGE (JACK + PIEZO)
  //
  // We intentionally drive the two outputs differently:
  //
  // 1) Audio Jack (slice 4): classic centered PWM "DAC"
  //    - Fixed midpoint at PWM_MID (127 for 8-bit, 256 for 9-bit, 512 for 10-bit)
  //    - Symmetric headroom, lowest distortion into an audio path
  //
  // 2) Piezo (slice 3): "moving midpoint" drive
  //    - Midpoint follows the *actual amplitude* derived from envSum
  //    - Prevents the piezo from sitting at half supply when quiet
  //    - Midpoint glides down as the last voice fades (no sudden hiss stop)
  //
  // This keeps jack quality higher while making the piezo less noisy.
  // ============================================================

  // ------------------------------------------------------------
  // 1) Build a normalized signed sample from the mixed signal.
  //
  // "scaled" already includes:
  //   - mix of all voices (signed)
  //   - smooth poly attenuation (attenFinal)
  //   - master volume (velWheel)
  //
  // We still need to convert it to a small signed number suitable for PWM.
  //
  // IMPORTANT: This OUTPUT_SHIFT is the main gain staging control.
  // If output is too quiet, decrease it. If it clips/distorts, increase it.
  // Higher PWM resolutions can typically use slightly smaller shifts.
  // ------------------------------------------------------------
  // JACK idle behavior: stay centered.
  // PIEZO idle behavior: off (0).
  if ((voices == 0 || velWheel.curValue == 0) && !metronomeAudible) {
    output.voices = voices;
    output.profileFlags = profileFlags;
    return output;
  }

  // Convert scaled mix -> signed sample in [-SHAPE_CLAMP..SHAPE_CLAMP]
  int32_t sample = 0;
  if (voices != 0 && velWheel.curValue != 0) {
    sample = scaled >> OUTPUT_SHIFT;
    if (sample >  SHAPE_CLAMP) sample =  SHAPE_CLAMP;
    if (sample < -SHAPE_CLAMP) sample = -SHAPE_CLAMP;
    if (synthDrive != SYNTH_DRIVE_OFF) {
      sample = applySynthDrive(sample);
    }
  }
  sample += metronomeSample;
  if (sample >  SHAPE_CLAMP) sample =  SHAPE_CLAMP;
  if (sample < -SHAPE_CLAMP) sample = -SHAPE_CLAMP;

  // ----- JACK: fixed midpoint with V1.2 headphone-only output cap -----
  int32_t jackSample = sample;
  if (headphoneVolumeCap < HEADPHONE_VOLUME_CAP_FULL) {
    jackSample = (jackSample * static_cast<int32_t>(headphoneVolumeCap)) >> 7;
  }
  int32_t jack = PWM_MID + jackSample;
  if (jack < 0) jack = 0;
  if (jack > (int32_t)PWM_WRAP) jack = PWM_WRAP;
  uint16_t jackLevel = (uint16_t)jack;

  // ----- PIEZO: midpoint follows "actual amplitude" from envSum -----
  //
  // IMPORTANT: envSum is sum of envelopes (0..~524k). We want ONE full voice
  // (envSum ~ 65535) to produce full piezo amplitude. So we shift by 9 (8-bit),
  // 8 (9-bit), or 7 (10-bit). With multiple voices envSum grows, so we clamp.
  //
  // This makes piezo loud enough and ensures it fades smoothly as envSum falls.
  //
  static uint16_t piezoA = 0; // smoothed midpoint/amplitude in PWM units [0..PWM_MID]

  // Map envSum -> A_target in [0..PWM_MID]
  uint32_t A_target = (envSum + (1u << (ENV_TO_A_SHIFT - 1))) >> ENV_TO_A_SHIFT;
  if (A_target > (uint32_t)PWM_MID) A_target = PWM_MID;

  // Apply master volume (0..127, where 127 is full). Keep it consistent with jack scaling.
  A_target = (A_target * (uint32_t)velWheel.curValue) >> 7;
  if (metronomeAudible && A_target < static_cast<uint32_t>(PWM_MID)) {
    // The beep sample is already volume-scaled. Give it full piezo headroom so
    // the moving-midpoint drive does not attenuate it a second time.
    A_target = PWM_MID;
  }

  // Smooth A so the piezo hiss doesn't abruptly stop (and to avoid end-click).
  // Smaller shift = faster response; larger = smoother.
  piezoA += (int16_t)((int32_t)A_target - (int32_t)piezoA) >> 3;

  // If very small, turn fully off (by now it’s near 0 so this won’t click).
  if (piezoA <= PIEZO_OFF_THRESHOLD) piezoA = 0;

  int32_t piezoLevel = 0;
  if (!(audioD & AUDIO_PIEZO)) {
    piezoA = 0;
  } else if (piezoA > 0) {
    // Scale sample [-SHAPE_CLAMP..SHAPE_CLAMP] -> outPiezo [-piezoA..+piezoA].
    // Use a power-of-two fixed-point scale to keep the piezo path cheap in the
    // audio renderer.
    profileFlags |= ISR_PROFILE_FLAG_PIEZO_SCALE;
    int32_t outPiezo = scalePiezoSample(sample, piezoA);

    // Midpoint follows amplitude: range [0..2*piezoA]
    piezoLevel = (int32_t)piezoA + outPiezo;
    int32_t piezoMax = (int32_t)piezoA * 2;

    if (piezoLevel < 0) piezoLevel = 0;
    if (piezoLevel > piezoMax) piezoLevel = piezoMax;
    if (piezoLevel > (int32_t)PWM_WRAP) piezoLevel = PWM_WRAP;
  }
  uint16_t piezoOut = (uint16_t)piezoLevel;

  output.piezo = piezoOut;
  output.jack = jackLevel;
  output.voices = voices;
  output.profileFlags = profileFlags;
  return output;
}

// Legacy direct renderer retained for diagnostics/fallback; the normal synth
// output path is DMA-buffered.
void RAM_FUNC(poll)() {
  hw_clear_bits(&timer_hw->intr, 1u << ALARM_NUM);
  timer_hw->alarm[ALARM_NUM] = readClock() + POLL_INTERVAL_IN_MICROSECONDS;
  uint32_t _isrStart = isrProfilingEnabled ? timer_hw->timerawl : 0;
  AudioOutputLevels output = renderAudioOutputLevels();
  writeAudioOutputLevels(output.piezo, output.jack);
  if (_isrStart) {
    recordISRProfileSample(_isrStart, output.voices, output.profileFlags);
  }
}

uint32_t audioDmaBuffers[2][AUDIO_DMA_BUFFER_SAMPLE_COUNT] = {};
uint32_t audioDmaSilenceBuffer[AUDIO_DMA_BUFFER_SAMPLE_COUNT] = {};
volatile bool audioDmaBufferReady[2] = { false, false };
volatile bool audioDmaBufferFree[2] = { true, true };
volatile uint8_t audioDmaActiveBuffer = 0;
volatile uint32_t audioDmaUnderrunCount = 0;
int audioDmaChannel = -1;
byte audioDmaActiveDestination = AUDIO_NONE;
uint8_t audioDmaActiveSlice = AJACK_SLICE;
uintptr_t audioDmaWriteAddress = 0;
dma_channel_config audioDmaConfig;
std::atomic<bool> synthRuntimeReady = false;

inline byte RAM_FUNC(selectedAudioDmaDestination)() {
  byte destination = audioD;
  if (destination & AUDIO_AJACK) {
    return AUDIO_AJACK;
  }
  if (destination & AUDIO_PIEZO) {
    return AUDIO_PIEZO;
  }
  return AUDIO_NONE;
}

inline uint8_t RAM_FUNC(audioDmaSliceForDestination)(byte destination) {
  return (destination == AUDIO_PIEZO) ? PIEZO_SLICE : AJACK_SLICE;
}

inline uint16_t RAM_FUNC(audioDmaLevelForDestination)(const AudioOutputLevels& levels, byte destination) {
  if (destination == AUDIO_PIEZO) {
    return levels.piezo;
  }
  if (destination == AUDIO_AJACK) {
    return levels.jack;
  }
  return static_cast<uint16_t>(PWM_MID);
}

inline uint32_t RAM_FUNC(audioDmaEncodeLevel)(uint16_t level) {
  return static_cast<uint32_t>(level) << AUDIO_PWM_CC_LEVEL_SHIFT;
}

void RAM_FUNC(setInactiveAudioOutputsForDestination)(byte destination) {
  if (destination == AUDIO_PIEZO) {
    pwm_set_chan_level(AJACK_SLICE, AJACK_CHNL, static_cast<uint16_t>(PWM_MID));
  } else if (destination == AUDIO_AJACK) {
    pwm_set_chan_level(PIEZO_SLICE, PIEZO_CHNL, 0);
  } else {
    writeAudioOutputLevels(0, static_cast<uint16_t>(PWM_MID));
  }
}

void RAM_FUNC(startAudioDmaTransfer)(uint8_t bufferIndex) {
  audioDmaActiveBuffer = bufferIndex;
  audioDmaBufferReady[bufferIndex] = false;
  audioDmaBufferFree[bufferIndex] = false;
  __dmb();
  dma_channel_set_read_addr(audioDmaChannel, audioDmaBuffers[bufferIndex], false);
  dma_channel_set_write_addr(audioDmaChannel, reinterpret_cast<void*>(audioDmaWriteAddress), false);
  dma_channel_set_trans_count(audioDmaChannel, AUDIO_DMA_BUFFER_SAMPLE_COUNT, true);
}

void RAM_FUNC(startAudioDmaSilenceTransfer)() {
  __dmb();
  dma_channel_set_read_addr(audioDmaChannel, audioDmaSilenceBuffer, false);
  dma_channel_set_write_addr(audioDmaChannel, reinterpret_cast<void*>(audioDmaWriteAddress), false);
  dma_channel_set_trans_count(audioDmaChannel, AUDIO_DMA_BUFFER_SAMPLE_COUNT, true);
}

void RAM_FUNC(audioDmaIrqHandler)() {
  if (audioDmaChannel < 0) {
    return;
  }
  dma_hw->ints0 = 1u << audioDmaChannel;

  uint8_t finishedBuffer = audioDmaActiveBuffer;
  audioDmaBufferFree[finishedBuffer] = true;
  uint8_t nextBuffer = static_cast<uint8_t>(finishedBuffer ^ 1u);
  if (audioDmaBufferReady[nextBuffer]) {
    startAudioDmaTransfer(nextBuffer);
  } else {
    ++audioDmaUnderrunCount;
    startAudioDmaSilenceTransfer();
  }
}

void fillAudioDmaSilenceBuffer(byte destination) {
  uint16_t level = (destination == AUDIO_PIEZO) ? 0 : static_cast<uint16_t>(PWM_MID);
  uint32_t encoded = audioDmaEncodeLevel(level);
  for (uint16_t i = 0; i < AUDIO_DMA_BUFFER_SAMPLE_COUNT; ++i) {
    audioDmaSilenceBuffer[i] = encoded;
  }
}

void RAM_FUNC(fillAudioDmaBuffer)(uint8_t bufferIndex, byte destination) {
  uint32_t profileStart = isrProfilingEnabled ? timer_hw->timerawl : 0;
  uint8_t maxVoices = 0;
  uint8_t combinedFlags = 0;
  uint32_t* buffer = audioDmaBuffers[bufferIndex];
  for (uint16_t sampleIndex = 0; sampleIndex < AUDIO_DMA_BUFFER_SAMPLE_COUNT; ++sampleIndex) {
    AudioOutputLevels levels = renderAudioOutputLevels();
    if (levels.voices > maxVoices) {
      maxVoices = levels.voices;
    }
    combinedFlags |= levels.profileFlags;
    buffer[sampleIndex] = audioDmaEncodeLevel(audioDmaLevelForDestination(levels, destination));
  }
  if (profileStart) {
    recordAudioBufferProfileSample(profileStart, maxVoices, combinedFlags);
  }
  __dmb();
  audioDmaBufferFree[bufferIndex] = false;
  audioDmaBufferReady[bufferIndex] = true;
}

void stopAudioDma() {
  if (audioDmaChannel >= 0) {
    dma_channel_abort(audioDmaChannel);
  }
  audioDmaBufferReady[0] = false;
  audioDmaBufferReady[1] = false;
  audioDmaBufferFree[0] = true;
  audioDmaBufferFree[1] = true;
  writeAudioOutputLevels(0, static_cast<uint16_t>(PWM_MID));
}

void startAudioDmaForDestination(byte destination) {
  stopAudioDma();
  audioDmaActiveDestination = destination;
  audioDmaActiveSlice = audioDmaSliceForDestination(destination);
  audioDmaWriteAddress = reinterpret_cast<uintptr_t>(&pwm_hw->slice[audioDmaActiveSlice].cc);
  setInactiveAudioOutputsForDestination(destination);
  fillAudioDmaSilenceBuffer(destination);

  if (destination == AUDIO_NONE || audioDmaChannel < 0) {
    return;
  }

  dma_channel_configure(audioDmaChannel,
                        &audioDmaConfig,
                        reinterpret_cast<void*>(audioDmaWriteAddress),
                        audioDmaBuffers[0],
                        AUDIO_DMA_BUFFER_SAMPLE_COUNT,
                        false);
  fillAudioDmaBuffer(0, destination);
  fillAudioDmaBuffer(1, destination);
  startAudioDmaTransfer(0);
}

void serviceAudioDmaBuffers() {
  if (audioDmaChannel < 0) {
    return;
  }

  byte destination = selectedAudioDmaDestination();
  if (destination != audioDmaActiveDestination) {
    startAudioDmaForDestination(destination);
    return;
  }

  for (uint8_t bufferIndex = 0; bufferIndex < 2; ++bufferIndex) {
    if (audioDmaBufferFree[bufferIndex] && !audioDmaBufferReady[bufferIndex]) {
      fillAudioDmaBuffer(bufferIndex, destination);
    }
  }
}

void setupAudioDmaTimer() {
  pwm_set_phase_correct(AUDIO_DMA_TIMER_SLICE, false);
  pwm_set_wrap(AUDIO_DMA_TIMER_SLICE, AUDIO_DMA_TIMER_WRAP);
  pwm_set_clkdiv(AUDIO_DMA_TIMER_SLICE, static_cast<float>(AUDIO_DMA_PWM_STEPS));
  pwm_set_chan_level(AUDIO_DMA_TIMER_SLICE, PWM_CHAN_A, 0);
  pwm_set_enabled(AUDIO_DMA_TIMER_SLICE, true);
}

void setupAudioDma() {
  setupAudioDmaTimer();
  audioDmaChannel = dma_claim_unused_channel(true);
  audioDmaConfig = dma_channel_get_default_config(audioDmaChannel);
  channel_config_set_transfer_data_size(&audioDmaConfig, DMA_SIZE_32);
  channel_config_set_read_increment(&audioDmaConfig, true);
  channel_config_set_write_increment(&audioDmaConfig, false);
  channel_config_set_dreq(&audioDmaConfig, pwm_get_dreq(AUDIO_DMA_TIMER_SLICE));
  dma_channel_set_irq0_enabled(audioDmaChannel, true);
  irq_set_exclusive_handler(DMA_IRQ_0, audioDmaIrqHandler);
  irq_set_priority(DMA_IRQ_0, 0x00);
  irq_set_enabled(DMA_IRQ_0, true);
  startAudioDmaForDestination(selectedAudioDmaDestination());
}
// RUN ON CORE 1
byte isoTwoTwentySix(float f) {
  /*
      a very crude implementation of ISO 226
      equal loudness curves
        Hz dB  Amp ~ sqrt(10^(dB/10))
       200  0  8
       800 -3  6
      1500  0  8
      3250 -6  4
      5000  0  8
    */
  if ((f < 8.0) || (f > 12500.0)) {  // really crude low- and high-pass
    return 0;
  } else {
    if (EQUAL_LOUDNESS_ADJUST) {
      if ((f <= 200.0) || (f >= 5000.0)) {
        return 8;
      } else {
        if (f < 1500.0) {
          return 6 + 2 * (float)(abs(f - 800) / 700);
        } else {
          return 4 + 4 * (float)(abs(f - 3250) / 1750);
        }
      }
    } else {
      return 8;
    }
  }
}
inline void recomputePitchBendFactor() {
  pitchBendFactor = exp2(pbWheel.curValue * DEFAULT_PITCH_BEND_RANGE_SEMITONES / 98304.0f);
}

inline void RAM_FUNC(clearSynthPortamento)(uint8_t channelIndex) {
  synth[channelIndex].glideStep = 0;
  synth[channelIndex].glideSamplesRemaining = 0;
}

inline void RAM_FUNC(beginSynthPortamento)(uint8_t channelIndex, uint32_t targetIncrement) {
  uint32_t remaining = synthPortamentoTicks;
  if (remaining == 0 || synth[channelIndex].increment == 0 || synth[channelIndex].targetIncrement == 0) {
    clearSynthPortamento(channelIndex);
    synth[channelIndex].increment = targetIncrement;
    return;
  }

  uint32_t currentIncrement = synth[channelIndex].increment;
  if (currentIncrement == targetIncrement) {
    clearSynthPortamento(channelIndex);
    return;
  }

  uint32_t distance = (targetIncrement > currentIncrement)
                        ? (targetIncrement - currentIncrement)
                        : (currentIncrement - targetIncrement);
  uint32_t step = distance / remaining;
  synth[channelIndex].glideStep = step ? step : 1;
  synth[channelIndex].glideSamplesRemaining = remaining;
}

void RAM_FUNC(setSynthFreq)(float frequency, byte channel, bool resetPhase = false, bool allowPortamento = false) {
  if (channel == 0) {
    return;
  }
  byte c = channel - 1;
  float tunedFrequency = frequency;
  if ((useDynamicJustIntonation || useJustIntonationBPM) && c < POLYPHONY_LIMIT) {
    int16_t owner = synthChannelOwners[c].load(std::memory_order_relaxed);
    if (owner >= 0 && owner < BTN_COUNT) {
      tunedFrequency *= h[owner].jiFrequencyMultiplier;
    }
  }
  float f = tunedFrequency * pitchBendFactor;
  uint32_t newIncrement = oscillatorIncrementFromFrequency(f);
  if (newIncrement == 0) {
    synth[c].increment = 0;
    synth[c].targetIncrement = 0;
    synth[c].counter = 0;
    clearSynthPortamento(c);
    synth[c].eq = 0;
    return;
  }

  bool canPortamento = allowPortamento
                    && synthPortamentoTicks > 0
                    && synth[c].increment != 0
                    && synth[c].targetIncrement != 0;
  if (canPortamento) {
    synth[c].targetIncrement = newIncrement;
    beginSynthPortamento(c, newIncrement);
  } else {
    clearSynthPortamento(c);
    if (resetPhase) {
      synth[c].counter = 0;
    }
    if (resetPhase || allowPortamento || synth[c].increment == 0 || synth[c].targetIncrement == 0) {
      synth[c].increment = newIncrement;
    }
    synth[c].targetIncrement = newIncrement;
  }
  synth[c].eq = isoTwoTwentySix(f);
  if (currWave == WAVEFORM_HYBRID) {
    if (f < TRANSITION_SQUARE) {
      synth[c].b = 128;
    } else if (f < TRANSITION_SAW_LOW) {
      synth[c].b = (byte)(128 + 127 * (f - TRANSITION_SQUARE) / (TRANSITION_SAW_LOW - TRANSITION_SQUARE));
    } else if (f < TRANSITION_SAW_HIGH) {
      synth[c].b = 255;
    } else if (f < TRANSITION_TRIANGLE) {
      synth[c].b = (byte)(127 + 128 * (TRANSITION_TRIANGLE - f) / (TRANSITION_TRIANGLE - TRANSITION_SAW_HIGH));
    } else {
      synth[c].b = 127;
    }
    if (f < TRANSITION_SAW_LOW) {
      synth[c].a = 255 - synth[c].b;
      synth[c].c = 255;
    } else {
      synth[c].a = 0;
      synth[c].c = synth[c].b;
    }
    if (synth[c].a > 126) {
      synth[c].ab = 65535;
    } else {
      synth[c].ab = 65535 / (synth[c].b - synth[c].a - 1);
    }
    synth[c].cd = 65535 / (256 - synth[c].c);
  }
}

void RAM_FUNC(beginEnvelopeAttack)(uint8_t channel) {
  channelInUse[channel].store(true, std::memory_order_relaxed);
  releaseRetries[channel] = 0;
  releaseRetryCountdown[channel] = 0;
  // Reusing a voice discards any older "voice finished" event that core 1 may
  // have published for the previous note on this channel.
  clearPendingVoiceFreed(channel);
  publishEnvelopeCommand(channel, EnvelopeCommand::StartAttack);
}

void RAM_FUNC(beginEnvelopeRelease)(uint8_t channel) {
  if (channel >= POLYPHONY_LIMIT) {
    return;
  }
  releaseRetries[channel] = releaseRetryLimit;
  releaseRetryCountdown[channel] = 0;
  publishEnvelopeCommand(channel, EnvelopeCommand::StartRelease);
}

// USE THIS IN MONO OR ARPEG MODE ONLY

int RAM_FUNC(arpeggiatorHeldIndex)(byte x) {
  for (uint8_t i = 0; i < arpeggiatorHeldNoteCount; ++i) {
    if (arpeggiatorHeldNotes[i] == x) {
      return i;
    }
  }
  return -1;
}

void RAM_FUNC(clearArpeggiatorHeldNotes)() {
  arpeggiatorHeldNoteCount = 0;
  arpeggiatorSequenceLength = 0;
  arpeggiatorSequenceCursor = 0;
}

void RAM_FUNC(registerArpeggiatorNoteOff)(byte x) {
  int index = arpeggiatorHeldIndex(x);
  if (index < 0) {
    return;
  }
  for (uint8_t i = static_cast<uint8_t>(index); i + 1 < arpeggiatorHeldNoteCount; ++i) {
    arpeggiatorHeldNotes[i] = arpeggiatorHeldNotes[i + 1];
  }
  --arpeggiatorHeldNoteCount;
  if (arpeggiatorHeldNoteCount == 0) {
    arpeggiatorSequenceCursor = 0;
  }
}

void RAM_FUNC(registerArpeggiatorNoteOn)(byte x) {
  if (x >= BTN_COUNT || h[x].isCmd || h[x].note >= 128) {
    return;
  }
  registerArpeggiatorNoteOff(x);
  if (arpeggiatorHeldNoteCount < BTN_COUNT) {
    arpeggiatorHeldNotes[arpeggiatorHeldNoteCount++] = x;
  }
}

bool RAM_FUNC(arpeggiatorPitchComesBefore)(byte left, byte right) {
  if (h[left].frequency < h[right].frequency) {
    return true;
  }
  if (h[left].frequency > h[right].frequency) {
    return false;
  }
  if (h[left].midiNoteIndex < h[right].midiNoteIndex) {
    return true;
  }
  if (h[left].midiNoteIndex > h[right].midiNoteIndex) {
    return false;
  }
  if (h[left].timePressed != h[right].timePressed) {
    return h[left].timePressed < h[right].timePressed;
  }
  return left < right;
}

void RAM_FUNC(appendArpeggiatorSequenceNote)(byte note) {
  if (arpeggiatorSequenceLength < ARPEGGIATOR_SEQUENCE_MAX) {
    arpeggiatorSequence[arpeggiatorSequenceLength++] = note;
  }
}

void RAM_FUNC(sortArpeggiatorSequenceByPitch)(bool descending) {
  for (uint16_t i = 1; i < arpeggiatorSequenceLength; ++i) {
    byte value = arpeggiatorSequence[i];
    uint16_t j = i;
    while (j > 0) {
      bool comesBefore = arpeggiatorPitchComesBefore(value, arpeggiatorSequence[j - 1]);
      if (descending) {
        comesBefore = arpeggiatorPitchComesBefore(arpeggiatorSequence[j - 1], value);
      }
      if (!comesBefore) {
        break;
      }
      arpeggiatorSequence[j] = arpeggiatorSequence[j - 1];
      --j;
    }
    arpeggiatorSequence[j] = value;
  }
}

void RAM_FUNC(buildArpeggiatorSequence)() {
  arpeggiatorSequenceLength = 0;
  if (arpeggiatorHeldNoteCount == 0) {
    arpeggiatorSequenceCursor = 0;
    return;
  }

  switch (arpeggiatorDirection) {
    case ARP_DIRECTION_ORDER_PLAYED:
      for (uint8_t i = 0; i < arpeggiatorHeldNoteCount; ++i) {
        appendArpeggiatorSequenceNote(arpeggiatorHeldNotes[i]);
      }
      break;
    case ARP_DIRECTION_REVERSE_PLAYED:
      for (uint8_t i = arpeggiatorHeldNoteCount; i > 0; --i) {
        appendArpeggiatorSequenceNote(arpeggiatorHeldNotes[i - 1]);
      }
      break;
    case ARP_DIRECTION_DOWN:
    case ARP_DIRECTION_DOWN_UP:
      for (uint8_t i = 0; i < arpeggiatorHeldNoteCount; ++i) {
        appendArpeggiatorSequenceNote(arpeggiatorHeldNotes[i]);
      }
      sortArpeggiatorSequenceByPitch(true);
      if (arpeggiatorDirection == ARP_DIRECTION_DOWN_UP && arpeggiatorSequenceLength > 2) {
        for (uint16_t i = arpeggiatorSequenceLength - 2; i > 0; --i) {
          appendArpeggiatorSequenceNote(arpeggiatorSequence[i]);
        }
      }
      break;
    case ARP_DIRECTION_UP_DOWN:
    case ARP_DIRECTION_UP:
    default:
      for (uint8_t i = 0; i < arpeggiatorHeldNoteCount; ++i) {
        appendArpeggiatorSequenceNote(arpeggiatorHeldNotes[i]);
      }
      sortArpeggiatorSequenceByPitch(false);
      if (arpeggiatorDirection == ARP_DIRECTION_UP_DOWN && arpeggiatorSequenceLength > 2) {
        for (uint16_t i = arpeggiatorSequenceLength - 2; i > 0; --i) {
          appendArpeggiatorSequenceNote(arpeggiatorSequence[i]);
        }
      }
      break;
  }

  if (arpeggiatorSequenceCursor >= arpeggiatorSequenceLength) {
    arpeggiatorSequenceCursor = 0;
  }
}

void RAM_FUNC(setArpeggiatorCursorAfter)(byte note) {
  if (arpeggiatorDirection == ARP_DIRECTION_RANDOM) {
    return;
  }
  buildArpeggiatorSequence();
  for (uint16_t i = 0; i < arpeggiatorSequenceLength; ++i) {
    if (arpeggiatorSequence[i] == note) {
      arpeggiatorSequenceCursor = static_cast<uint16_t>((i + 1) % arpeggiatorSequenceLength);
      return;
    }
  }
}

byte RAM_FUNC(findNewestHeldNote)() {
  return arpeggiatorHeldNoteCount == 0 ? UNUSED_NOTE : arpeggiatorHeldNotes[arpeggiatorHeldNoteCount - 1];
}

byte RAM_FUNC(findNextArpeggiatedNote)() {
  if (arpeggiatorHeldNoteCount == 0) {
    return UNUSED_NOTE;
  }
  if (arpeggiatorDirection == ARP_DIRECTION_RANDOM) {
    arpeggiatorRandomState = (arpeggiatorRandomState * 1664525u) + 1013904223u + static_cast<uint32_t>(runTime);
    return arpeggiatorHeldNotes[(arpeggiatorRandomState >> 16) % arpeggiatorHeldNoteCount];
  }

  buildArpeggiatorSequence();
  if (arpeggiatorSequenceLength == 0) {
    return UNUSED_NOTE;
  }
  byte nextNote = arpeggiatorSequence[arpeggiatorSequenceCursor];
  arpeggiatorSequenceCursor = static_cast<uint16_t>((arpeggiatorSequenceCursor + 1) % arpeggiatorSequenceLength);
  return nextNote;
}

void RAM_FUNC(replaceMonoSynthWith)(byte x, bool retriggerEnvelope = true, bool allowPortamento = false, bool forceRetrigger = false) {
  if (arpeggiatingNow == x && !forceRetrigger) {
    return;
  }
  bool hadActiveNote = arpeggiatingNow != UNUSED_NOTE && channelInUse[0].load(std::memory_order_relaxed);
  if (arpeggiatingNow != UNUSED_NOTE && arpeggiatingNow < BTN_COUNT) {
    h[arpeggiatingNow].synthCh = 0;
  }
  arpeggiatingNow = x;
  if (arpeggiatingNow != UNUSED_NOTE) {
    h[arpeggiatingNow].synthCh = 1;
    synthChannelOwners[0].store(static_cast<int16_t>(arpeggiatingNow), std::memory_order_relaxed);
    if (retriggerEnvelope || !hadActiveNote) {
      voiceGenerations[0].store(nextVoiceGeneration.fetch_add(1, std::memory_order_relaxed), std::memory_order_relaxed);
      beginEnvelopeAttack(0);
    }
    bool usePortamento = allowPortamento && hadActiveNote;
    bool shouldResetPhase = (retriggerEnvelope || !hadActiveNote) && !(usePortamento && synthPortamentoTicks > 0);
    setSynthFreq(h[arpeggiatingNow].frequency, 1, shouldResetPhase, usePortamento);
  } else {
    synthChannelOwners[0].store(NO_SYNTH_OWNER, std::memory_order_relaxed);
    beginEnvelopeRelease(0);
  }
}

void RAM_FUNC(resetSynthFreqs)() {
  while (!synthChQueue.empty()) {
    synthChQueue.pop();
  }
  nextVoiceGeneration.store(1, std::memory_order_relaxed);
  for (byte i = 0; i < POLYPHONY_LIMIT; i++) {
    synth[i].increment = 0;
    synth[i].targetIncrement = 0;
    synth[i].counter = 0;
    clearSynthPortamento(i);
    publishEnvelopeCommand(i, EnvelopeCommand::Reset);
    channelInUse[i].store(false, std::memory_order_relaxed);
    voiceGenerations[i].store(0, std::memory_order_relaxed);
    synthChannelOwners[i].store(NO_SYNTH_OWNER, std::memory_order_relaxed);
    clearPendingVoiceFreed(i);
    releaseRetries[i] = 0;
    releaseRetryCountdown[i] = 0;
  }
  for (byte i = 0; i < BTN_COUNT; i++) {
    h[i].synthCh = 0;
  }
  arpeggiatingNow = UNUSED_NOTE;
  clearArpeggiatorHeldNotes();
  if (isPolyPlaybackMode(playbackMode)) {
    uint8_t voiceLimit = currentSynthVoiceLimit();
    for (byte i = 0; i < voiceLimit; i++) {
      synthChQueue.push(i + 1);
    }
  }
}

void synthWaveformChanged() {
  resetSynthFreqs();
  loadSelectedSynthWaveform();
}

void sendProgramChange() {
  if (programChange == 0) {
    return;  // 0 indicates "no program" selected yet.
  }
  byte targetChannel = primaryMIDIChannel();
  withMIDI([&](auto& M) { M.sendProgramChange(programChange - 1, targetChannel); });
}

void RAM_FUNC(updateSynthWithNewFreqs)() {
  recomputePitchBendFactor();
  byte targetChannel = primaryMIDIChannel();
  withMIDI([&](auto& M) { M.sendPitchBend(pbWheel.curValue, targetChannel); });
  for (byte i = 0; i < BTN_COUNT; i++) {
    if (!(h[i].isCmd)) {
      if (h[i].synthCh) {
        setSynthFreq(h[i].frequency, h[i].synthCh);  // pass all notes thru synth again if the pitch bend changes
      }
    }
  }
}

void RAM_FUNC(processEnvelopeReleases)() {
  for (uint8_t i = 0; i < POLYPHONY_LIMIT; ++i) {
    if (consumeVoiceFreed(i)) {
      channelInUse[i].store(false, std::memory_order_relaxed);
      voiceGenerations[i].store(0, std::memory_order_relaxed);
      int16_t owner = synthChannelOwners[i].load(std::memory_order_relaxed);
      synthChannelOwners[i].store(NO_SYNTH_OWNER, std::memory_order_relaxed);
      if (owner >= 0 && owner < BTN_COUNT) {
        if (h[owner].synthCh == static_cast<byte>(i + 1)) {
          h[owner].synthCh = 0;
        }
      }
      if (isPolyPlaybackMode(playbackMode) && i < currentSynthVoiceLimit()) {
        synthChQueue.push(i + 1);
      }
      releaseRetries[i] = 0;
      releaseRetryCountdown[i] = 0;
    }
  }
}

void RAM_FUNC(retryPendingReleases)() {
  uint8_t voiceLimit = currentSynthVoiceLimit();
  for (uint8_t i = 0; i < voiceLimit; ++i) {
    uint8_t retries = releaseRetries[i];
    if (retries == 0) {
      continue;
    }
    if (!channelInUse[i].load(std::memory_order_relaxed)) {
      releaseRetries[i] = 0;
      releaseRetryCountdown[i] = 0;
      continue;
    }
    if (releaseRetryCountdown[i] > 0) {
      --releaseRetryCountdown[i];
      continue;
    }
    publishEnvelopeCommand(i, EnvelopeCommand::StartRelease);
    releaseRetryCountdown[i] = releaseRetryDelayLoops;
    releaseRetries[i] = static_cast<uint8_t>(retries - 1);
  }
}

bool RAM_FUNC(stealOldestSynthVoice)(byte& channelOut, int16_t& previousOwner) {
  previousOwner = NO_SYNTH_OWNER;
  uint32_t oldestGeneration = std::numeric_limits<uint32_t>::max();
  int8_t oldestIndex = -1;
  uint8_t voiceLimit = currentSynthVoiceLimit();
  for (uint8_t i = 0; i < voiceLimit; ++i) {
    if (!channelInUse[i].load(std::memory_order_relaxed)) {
      continue;
    }
    if (synthChannelOwners[i].load(std::memory_order_relaxed) == NO_SYNTH_OWNER) {
      continue;
    }
    uint32_t generation = voiceGenerations[i].load(std::memory_order_relaxed);
    if (generation == 0) {
      continue;
    }
    if (generation < oldestGeneration) {
      oldestGeneration = generation;
      oldestIndex = static_cast<int8_t>(i);
    }
  }
  if (oldestIndex < 0) {
    return false;
  }
  previousOwner = synthChannelOwners[oldestIndex].load(std::memory_order_relaxed);
  channelOut = static_cast<byte>(oldestIndex + 1);
  return true;
}

void RAM_FUNC(trySynthNoteOn)(byte x) {
  if (playbackMode == SYNTH_OFF) {
    return;
  }
  if (isPolyPlaybackMode(playbackMode)) {
    processEnvelopeReleases();
    if (synthChQueue.empty()) {
      byte stolenChannel = 0;
      int16_t previousOwner = NO_SYNTH_OWNER;
      if (!stealOldestSynthVoice(stolenChannel, previousOwner)) {
        sendToLog("synth channels all firing, so did not add one");
        return;
      }
      if (previousOwner >= 0 && previousOwner < BTN_COUNT) {
        if (h[previousOwner].synthCh == stolenChannel) {
          h[previousOwner].synthCh = 0;
        }
      }
      h[x].synthCh = stolenChannel;
      synthChannelOwners[stolenChannel - 1].store(static_cast<int16_t>(x), std::memory_order_relaxed);
      voiceGenerations[stolenChannel - 1].store(nextVoiceGeneration.fetch_add(1, std::memory_order_relaxed), std::memory_order_relaxed);
      beginEnvelopeAttack(stolenChannel - 1);
      setSynthFreq(h[x].frequency, stolenChannel, true);
      sendToLog("stole synth channel " + std::to_string(stolenChannel));
      return;
    }
    byte channel = synthChQueue.front();
    synthChQueue.pop();
    h[x].synthCh = channel;
    synthChannelOwners[channel - 1].store(static_cast<int16_t>(x), std::memory_order_relaxed);
    voiceGenerations[channel - 1].store(nextVoiceGeneration.fetch_add(1, std::memory_order_relaxed), std::memory_order_relaxed);
    beginEnvelopeAttack(channel - 1);
    setSynthFreq(h[x].frequency, channel, true);
    sendToLog("popped " + std::to_string(channel) + " off the synth queue");
  } else if (h[x].MIDIch) {
    registerArpeggiatorNoteOn(x);
    if (playbackMode == SYNTH_ARPEGGIO) {
      replaceMonoSynthWith(x, true, false, true);
      setArpeggiatorCursorAfter(x);
    } else if (playbackMode == SYNTH_MONO_LEGATO) {
      replaceMonoSynthWith(x, false, true);
    } else {
      replaceMonoSynthWith(x, true, true);
    }
  }
}

void RAM_FUNC(trySynthNoteOff)(byte x) {
  if (playbackMode && !isPolyPlaybackMode(playbackMode)) {
    registerArpeggiatorNoteOff(x);
    if (arpeggiatingNow == x) {
      byte nextNote = (playbackMode == SYNTH_ARPEGGIO) ? findNextArpeggiatedNote() : findNewestHeldNote();
      if (playbackMode == SYNTH_ARPEGGIO) {
        replaceMonoSynthWith(nextNote, true, false, true);
      } else if (playbackMode == SYNTH_MONO_LEGATO) {
        replaceMonoSynthWith(nextNote, false, true);
      } else {
        replaceMonoSynthWith(nextNote, true, true);
      }
    }
    return;
  }

  if (!isPolyPlaybackMode(playbackMode)) {
    return;
  }

  if (h[x].synthCh) {
    uint8_t channel = h[x].synthCh;
    h[x].synthCh = 0;
    beginEnvelopeRelease(channel - 1);
    return;
  }

  // Fallback: the direct channel assignment was already cleared (e.g., by a voice steal),
  // but the synth voice is still owned by this hex. Look it up by owner.
  for (uint8_t i = 0; i < POLYPHONY_LIMIT; ++i) {
    if (!channelInUse[i].load(std::memory_order_relaxed)) {
      continue;
    }
    if (synthChannelOwners[i].load(std::memory_order_relaxed) == static_cast<int16_t>(x)) {
      synthChannelOwners[i].store(NO_SYNTH_OWNER, std::memory_order_relaxed);
      beginEnvelopeRelease(i);
      break;
    }
  }
}

void panicStopOutput() {
  sendToLog("Panic: stopping all MIDI and synth output.");

  for (byte channel = 1; channel <= 16; ++channel) {
    withMIDI([&](auto& M) {
      M.sendControlChange(120, 0, channel);
      M.sendControlChange(123, 0, channel);
    });
  }

  for (byte i = 0; i < BTN_COUNT; ++i) {
    h[i].MIDIch = 0;
    h[i].synthCh = 0;
    h[i].externalNoteDepth = 0;
    h[i].timePressed = 0;
    h[i].animate = 0;
  }

  pressedKeyIDs.clear();
  arpeggiatingNow = UNUSED_NOTE;
  resetSynthFreqs();
  refreshMidiRouting();
  strip.clear();
  strip.show();
}


void setupSynth(byte pin, byte slice) {
  gpio_set_function(pin, GPIO_FUNC_PWM);          // set that pin as PWM
  pwm_set_phase_correct(slice, true);             // phase correct sounds better
  pwm_set_wrap(slice, PWM_WRAP);                  // essentionally sets the "bit-rate"
  pwm_set_clkdiv(slice, 1.0f);                    // run at full clock speed
  pwm_set_chan_level(slice, PIEZO_CHNL, 0);       // initialize at zero to prevent whining sound
  pwm_set_enabled(slice, true);                   // ENGAGE!
  resetSynthFreqs();
  sendToLog("synth is ready.");
}

void RAM_FUNC(arpeggiate)() {
  if (delegatedControl) {
    return;
  }
  if (playbackMode == SYNTH_ARPEGGIO) {
    if (runTime - arpeggiateTime > arpeggiateLength) {
      arpeggiateTime = runTime;
      replaceMonoSynthWith(findNextArpeggiatedNote(), true, false, true);
    }
  }
}


#endif  // HEXBOARD_FIRMWARE_UNITY
